// GENERATED by build_page.py from dashboard.html. Edit dashboard.html, not this file.
// Fonts: Newsreader (SIL Open Font License, see assets/Newsreader-OFL.txt).
#pragma once

const char PAGE[] PROGMEM = R"rawliteral(<!doctype html>
<html lang="en"><head>
<meta charset="utf-8">
<meta name="viewport" content="width=device-width,initial-scale=1,viewport-fit=cover">
<meta name="theme-color" content="#000000">
<title>Tank Level</title>
<style>
@font-face{font-family:"News";src:url(data:font/woff2;base64,d09GMgABAAAAACysABAAAAAAWrwAACxNAAEAAAAAAAAAAAAAAAAAAAAAAAAAAAAAGhYbzUocegZgP1NUQVRiAIFCEQgK1TDGawE2AiQDg1wLgXAABCAFhSAHIAwHG21RRQdicB6gkKD99VHUBU2q+yiqMqdF/5+SGzIE1sHUdXJEYJTp7cmYhnZ2G0ZdVFw2knpTvB3c5sorP9M1glVGq3+kS5qXkhxEfvN7rff8Tg4tRhh5xh/FlITt86mosrTL0kbQOEJjn+Ty8N9+z2+fM3PvE/3uuFokiiYSidVVKp3ukUQyGXh4dPv3EgIECDEkQcz+D1LEn0Lro+ozTqeOosPe2acua9cuc4fn5/WcqAtRYxg2erO/1ltjtraW20zUTNVMnavCNRfZriJdtIH3zH8Qf2fggYPVo+eCqRioUJLukJQa8R/3vz33J/wmSNiygIuIttEiHCCDptY++tADHPK7P/ZorUG6BRIqzTiN+F3prHqM2hnBPWGER8A907JVW14vo6RO5PrsVB8eRJ9+RACS/AQ1QIAFu3uPOMfAsRXAPzxfa59v78mmq7oTlhsFLEe4oPBRcjYzC3d7O8CzpHEqeeEJvwA74PKJi7ATniD+7xDLo2Mhv/xCmfz/c/XavF3O/8X5RbdQYmH+VlUDSRKqKpl3571k7rzJG1hKhpazkI+cKWWnQOx6qj5CCVgoUnU9FQ7Y1aP2wMe3QrnaympXzaW1HpJsK5aOQDc83tfMiWIZbX+s/EyXCcYII4wQQhxC+Me6lrPSoWYnFkMWC574737yAlNACuloDoGx3XqEs845hzDxodsXp2GiCm2MFeLBu+enwQGBUI0MFVOrJTgk1p9m4da/nvwpNjja11Z7kN1FU77WxPyzvW6fHb7qy4IqbXvqQNNla8IX2rm9uevGmeky79yxN29iHNWN1t6mNW582iRgTV7iZVl/701oY7SeabJ6d9va6cDW7Q/Pq9f3Xf26xyLeDGMOQpNQFKkLZTOZyVixWFN3afEa7UguIMqCJwjn5HVV6IfbMSFaV+TNLjuQONrlhHPGeJYA5JTkIm48ePH1+9FkRyCqiFMl6ATfPBRWdImIMoEsflFWMSpxKQmFbPWhory0QjgRToZatv6KjCr76+GCvX9a4VK4okMPp482EDAUZod74aGgeXiLcM3tNnwKX8LX8C18Dz/CUGbYkNKV5k/hZ1KLuicZrijqy5vxuWRwTecW7uwVd6aIlKR7nGadqu7moCa4SNRJYpfffmlUC9UwDSGEO1cnlEgmlNIorV7Gv3kWI6dFPhyzK0ophVPhtCZVZjWNVvZMQ72mJi28v9scOiBdXj1ufVoDDkPP2KYZcRhzmJhm6o4XwsMSzcPj8CQ8JbZ1x94dB9VOPO4w7jEeMB4xnjDOjDyZKFEx9XCFR1/STNaRkycz7IRz/LogBzonnc685BQpyYTqyFbvZKRPkR+YXcupn9N4AsN4UwjIs6MjY14XfeEO7sLREx4f5p02X1S8vMaMxFqpyxBleEk4l4gmEQ1j17C0iIREv+IuUppbxqd2lcSosOKLdLHhApIOcbugiA9aNIkmIiuE+/RWjhd/9J7egc4R6SS4D/1E81u2Xth7kfpYK1kHVteS4fYWS8OgMKWmYFzoIXzQuGjKznKKEcOIVzfxRKUwIcYX9VtDFhPoV9BUTNLCAgZLifv/Q+mZaJaoKEBMRDxsM0hpkVYto0UOJujI4JSebWlDiba4dMIVrnKN68UbkmwDmrB6ao9ZevPwFN821T3WHfzn0koULgxQZTnyhDQb21JGIdEFdyFTglGxJQ2BxSdpAmQVkHFpxoFQ8Dkz0kmKdBet37iuaB0Md51JCRuK+vIvW/L9bGsc+29HW2lxsMyJyZmIniJpjC5XpWYIfIFsBI/1O/c1o8OwV2sscuATrCKSklj0+5sa5kM1kIcERLp8XFvSEjZJNillm7T1MrbJapKzXz6rgqKeWLXhKvapmta0r7vuhIb1mvZp2aXtlI4yXZV6HukrNfDA0L9sK4zUGqs1scLUgYFCGV4kSdbesk5v29Y93+zgoMvwvmy3ZTrm6+SeO03uyQOPPH24s2p6yYaV0qoDdMH61GzHu90804rcOl8Hj4iJE4fqVmfNejlgRDySeb988OANRoTlJGQtrEs5fjOIAWY8sb9ITtwX9bDBTH52D14c/N1xxitrbAvITe/jmYVPapJbh8GDF8otmwI0hO1EFZHlbM53sG2RhBCPwKxEN1p22gN55EnPN++x+JQ1eVEig41mERvBd+mnuSC2TKfvbzaDWDvkAId3TwO5cvh/LuDwYhVoEw7XkQJKdZAyxXRFJHJkqtyOXE7hJ1YAhNltIgSEShJV7wOHdNFK227Eie1vu93KuZisFx7025RdyU6zKm3/2+XszJX927MxLOKmulGq3srkcFvptcglOqyF7KodjB4gwN7jEUkxMCJ+XMcgG0bDu0NE3DTT7PpTlD/TsUDHT3pH2Cpfa9KI9dcUgxLnEBSOIBxZyg3haezpFAEEFUeXuDRMqzwXVBBsDopIU2gCqW4yFFgVnvIKlQwZAMQBKUCof04gxdRg2/UsJp0TF2twcIaDi4lMIE2ygY00w0U5YX+J8HBAXrqQUU+kQy6cKNwMZqHL0vI1m52xUNFwjsqA0oEYyANW3D6Sa5Z2FVvkeMfAcPxJPnRYHViuuxBoNGbQ5xSikgkXfBxwCUWJulgMRE+iFLspoKdZPI7XWJ88aJYDSlDFSURU4CLiJh6VUrz4on6PyEQCRcVTKiGtja6GJ5gCUbZZFuu8JbT2FEwTh0qwPKkoBZAmk7Gr57jkYfMC2JEYFAVwYWRCJ2mBCOc5L/zRnAGCIHz4gW8fNAEM8HYVbhwJN7vOSoqYU1YhpCibpNR0HstfZfkcYViWxDQIyMbYOGyfCJTsySwKMSskdEkBpVlk/KQcTq2/rqgBbaU9bZHseEWpGTa7p0wKvLZK7bkIOa0RvyIshJCbR/zLfzQCOWqgFv9mFj4jyf8t9glJyOKA9a61PG84iw22eNPWd/RSLS4fxfYiWttzjUqWXcf4tKY6q22oXRkRVvf3Akb4jJ15gysvvsShxTjVcaamHx62ztW2U/7uOmcWysFECCvWMM1nOSpmiXrc+TOA2Xjup9bWW7f7gt0XkfCBxa0e2y3g9WPQ7ZrFrJwdEPISEqp+tkcd9SGhXTwStvXYzacz6zhRI46W8k59MNuHzeIQSMoB1JlOMRurKjYRGHLoR3UrvUYmBmG3GTZ9vkYOFoJrxDAeptTlOBurIn9gGQWdfYjMY8XPnyfLL+esfEygaNAwDwsr0HAM0jOTuQ7Dftt6I0XH1IkVVz/mjt89eOCRpw6d8WaFCmvxRcONFLA3vq0YzoVLcpOAhY6SS7JB19t57JHl2ssN7l1vN2iU2ASF6OWfmdxS53REb17q0jVX4b3rbtU7mqWbQMxJx0XcePDiU7/YLusTW0Lar9LSQw3axmHLRBhzyddteSjqnphZ4sQSaFlWeaQCSJFdCamsXAWsClZn1wRrRZbDhUjUTmXVS0MBNo8Rwtj8ZErHGoMHHnmatZ/IQIr6ZWkMjP0kT0w4AWKQSebcUVGvPgwMAF4AGBzoVQVMGMRaimLzGSGNufUEZOoasvRFqHv7vVyA3XA6Qmffoo43m90ErdBLYg+4A5u3VoT5J1KcYekd/XDI0jdxSdAB1EyWAjRJQOATACWw4UJBJ3CiFB4sEJfjBnSJu/aGRWZLTtq6Ya8XSteR58cotc6mGFtj39VM4A4BYRwQMTY3q2aV5kwOFzoIyIIgICABg+HCgfduLgM0O1ejcJe/46MeHZ166gczbiI7b3wGkbI9HjM6Z7UAW/ZccuaRDLQyATbzDycqhUFBGQrKUz8uU9lHAygKjJomMUMJlegX+HFi7pPw4gcKDTzNlspzZPJYBQ7FdFIJq9xfYVSl1rRiHaaBp2k9LYAcuIVN4JxhBt4PIV37UyOQMaMTPzU1xZb9kgsjdoFupv9ayB2fe+OBR56uf2ZQyyFLoM6jdVm0JYee69e2DmOSVYOQUAwXhIDE6zhE8gvDXjgIZC8+r/b+foTSd9tTE+7fdVeuJXO4fLb5tXf7AcqvMJhztp3HyWmBtmQy81zyRtfcc4inlYOdNh4RwtH2gXH2ciL+FsacVQNrwFaJiKOsZgeU0DLXQYxoiDmp7sdRxE4a9aOoViS18v7oooRjEWP6Pe9rlI86QIniIUC8heIECv37BdqLAMUAJHU8V3TZAmpIgUa6Q/5WX/yKoOJhrqLObAkSo/w/PAvaWwCIBVkAzam09rRrzYMGBBHOTYFzj5dBOLK+2vXqHwFjJKP6qN9N7lKUDjVNEN4RHYclNu7wRYMymnu1Z9M121Y9EQNsRFKOpBEkFyHbRNuZxXfIKqiCMG6xLp143aJ7g0g3xTMQbmlBZ75z8lkoghysitVMrB0sWi5wHp+p24JoA4PKKqA3iTtm0rClp5VpLOdX65wmjfbJ/beZ55bIy01Y/awsuF6Q/q+5GMkmOz4kWLmn8l7FrV/GfsU7zHS095YhtAp5nj6RmGgmaMtfrbsRrbhmAe1Ht8iESNW20LMpBmgeUk6gQG/vwN2BN2pBzvJJUBkgGEDxPgBxfYCPPBRlF64UFh5+v4/9t6QbCc9V7UL+Xv4C8WfANXYqo3UJblhDNtzJY4gCqSF1lHCsPXVkYeYFxtEjliysB+TuHNfCdvDBqmFOMEygCQ3CmsUAt63mQiuuhyIdw3rliNKdXOp8KNcQQ0CI0SJZvXxK004+h9GSHpit9SvRa0sQI+8ZkW7XntRCOhbZcG7R42BUssF1bRtMlB/TicQg2AfNPvWoskQBx/oW44OYne9JgzcV512vI+crwBCKCSQoc2aTdVZtmDDQz3Dj7d04ZGtWH4f9yfwcaRbqslikGj+26p/PnYZixv/XU2+BM4+Ijj7UjzajePWloLWgNXs4dA9a/r8htAPVIS2oKfnWm0hTBDKhUNVntBR1oOObC1onPvwUVIsAJgBQdBEUA1TnacoLrkP5UpG48O/pxLiICHXWJU9uMAwePSd2fITQF8pPkTgeboqASuc5vspYl+PFYjfLHw/AzolOaleJRmcXfZHjtanQuOmSvikeIzE4fjkJWeCoZxxset6Tdtxb/hFzXRRqumAz0LG9Ph/bEIG58kWXhK1LB7qKc+t06IBGfjaTGwdL1odadVLY8QTONxs0xPaQpZrIKlzpdBJ9gYubusORM7+oRTbk6EDLPwT5qvMR3Xm0S8h8YiBaTq9e9QtY3BCehmlAXZ6pyC9NQjIFahOD1iw6Ezd0gMFwX6ut6xRlRDcq5DwfTXxg13N3IJPUZM/whX35MfJgt4c+tCeYET87xzuDlGnA1MKDIMyG+3Uhm70wiqdD7Hzi0QNPcfHg4guC8INbd+8u4KJ1AVjzXwUCyPAnqXMM7kpJJ5mvTOXhJ7IFOPF/UjM7jqDKXf21g/BPM+IWFsb8l7HFHxT+qoI/k7j7JgauF4Me6lb+G0GsvXCzatTwto10Vu3YxCFqOysC4grvLMGDcwYSXhNyF0VWCjSiBIr/YSwkpIWQqHppaKazsOS3UkTAehZDTF1QU0dRT0/VwFCNbaphbglriwlvj43gTjUih/C0KA4sbCdiBbfeDiUGLAFWCdhAwkaY2ESwS0iFy/7CfAbmdkvyGSt2wVqmFC+2wdR6YLOysoQcsEdNDWAn7HQMDmxR/QrjThzMJZQn7MStq8dUKf1j2MwqbqyGsQ1EpLUEcwtLXptpdJKhxFqSlUwerIeJTcAaGRlhMWCLrCywTQw2OuLz26PhD9kO+tD9I22sZ8NQOEZ0f9S26pyKR9Z2KHha68oejDPvto12u8d9Mt6VHcS6vcxgS7e6bQa8uW0nv2JOIujYa/G0XHbFxWNwGOLZGDn4fQBGay93CChXdQmwXTNzaA6r7+7MQYRHH1uIhRXP3ju6KID438+vuhgv9TYqEZAxtoQFDoMQMmq8AShSxgwESDpgbM+H6B3AWhqn3qFGFpRyNGix6wntbxRgu46xJZVcjeXKoLMLWP/l2wdAmwnAT28Oa+EIOAnOApwHIJxsSUikUI0UqdLwFSGbmliJM/KFEhWSnKSj4yrDQnSDgacUE5uVaGMmgWcB/AJ4C5h+Dqz6Al4AvAEAUgqpekBECU54CE/5xu5oG686qfLOT0I5lbQq8Rf0ge8J35wHornYAWyLvYEuvBd/h71Pm1pZqoUl7zWLzjeCryvLohw3ZK8vEQlpEV9Rq/nGkpbSLE2LhLbd8rOilHyuy7qpyqocMVRVsUzF1LRePaQO42JEpRxfSoRcoZBsuxOjck4OusVVRSKS1Oup7xmaXFypaBee69V2YNFRtI2MSZjWSGYlS0oalteWG4Ge0yPCg4YGW1CsQrRqViycFM0hQfAe1J5JuzAO3hUdrNgTotgIVdljFhlx2k+XAuVrt+eavyio4/hfpag+RqpxrLl/ldeQ14aYoS4/GbDtiYmf8v0KCfGP0Fbqd5iOUkmanKSBqcJpV3jjhTA47pu+L04SDaBNfU+5lsl685JYQ2ZAOVZrSf5bdPHuXizL3Q7gACf9PXp0lVDcZubkWAuJWBf7SHSUW5vA/OXTwUW9CZltcFkKNVK8yCI1LUEYme5hcDy2ytLAnvbuCmV8j7fDdiUkD0MbBSrVOtS9Vhun6EuADho2FB0co1igvV1jICFzjguLVpmx5nVpiYY5Y0rY+ET2jznQzl9ZglcEl2qC4kqUfY8EioHpdCNXfKogW+0tpmg+iWnFAI3H1cPfJSEhF7n++iJNs2qYRKhM0u5Y6EVxmhXIavh28k8ESpvbgpfiqjuwIkCX2V+AiXHwYvJbCbVPPC7LqQjLnXhlFDw9cTBM7ujY+JrxQPHcodVjGm7Ij8zYiYl6LFFPVGYI13gpOLhK8GrXrPYVnb3SkFiRLHdaOs2uq7fKHn1zS7e3hE52oZQ0C3bd2sfhHc1T9/y2gBLcKik8QfUbQmyHGFBYS3xCnZ/dJb4H4WE3OFI+lE38pUsolQq3wORcXP8DBYhF1oc1SYKFHwBwwtNYviE0PKZ0JdZ1geD5t4DSZJirXZrBE2en/cQnWvIudNN2Bx0p6oADXz4rsWmFBmyOdTMLEdzELAsA0Z4Prf7EBkmzPjWUmKUBlKBJPUghJzC5KkOyKXLDIGZmqOyozLoDMI5CvKIyA5lLbUuzq2ntYII0sGK0Xb1hsN1Xh34ZDULYWUm8AtklFjYOMQwNS6GCjk2LXHyJgXN8Ak2EGUFqqlDcyHPPp0rVRZiPQ2SdmMkPFh9LuwwwRN6fOoBzB1TJVMXQQ0qXYiJGEqgGvmE7yjnJeUPb0QozCHU4BZHUfMZO1RePbNBM9BlNYeWA6pkUPa2l0W9FzQCTwKv9fro9Rmnzpv7TlWZCesdXVxzoRWc5Cd/07bZnrO+/Ju+tAMlBA0dt3G+TotweGMDIVL9EJX15j7fHZOubXbLjO0drCr1yQlVh4HWaa4aruhqrcbAkNHIwyAzOIHU0TA7ZKlqlQMBJRMqtAbWqdXsASvB+m1AGSnsQbnAukfJZDgvVCE5OangrrcKZdIRVyD9gFAjS7+PUqp7QAZvxFvIMoSze5P2m0/jy4/R5/T5Ci3vOWPJlM8+V6DcjhtESnQ3uRtRFddOX62gKBb5iFXoyVr1+FVFwG6wK7oDbW6N467miZ9eez3Bi/DYv1iJtMy9g3K5mB+yI2+LIFg7bLUGygHNzIo0pSNYV5UKPDJ1FA00JM2YFaMAorUb5qVuiQESxlhVabpj/xlZOGTxC5qim435b93Xu7sqft3489lFMUWH9vgfSFAZvIglr1EnKfyFb2eirr7Y3+0U+XSg0k15Q1PwmzO4qfNay3sh3nTmn6JJGlwFf/0yP7tsyoKw2uMKTrELWRbBKsNnemwqGUWXx09oLqxQcJinmPZF2uiikhGJmtcOkVkXJkS4LNSGN5gyxGDNI3oSppZgjB+/p/jD+qURU5wXmb3c2sjUbvqPUQ4sbbluOtwtuk62rMC1nAN2LvskTQPJh+kd8WHOddd2ZrnI+F+W6fLEbdUtezfVJvIB4e0nuZzoFWi9Bf0FDQh9pcl5OkukePJ0EPo/S5BUp7REPpQWbVfhZXUWOgCsCD9ygBWGRWZjUUR+WNpRwdGxZQSAiiAUDxzslTLM7WWoym3h8syabyjkaPlCb2I1jkQVV7Gl77DbagCc97pHpa8TarppeWVV/mm8LlaT4dq1Gu+O4hHDHfQDmqGh7nEBomtHIk6xgFCVtPCMNr9pyUnwiVs3kaZ6eQpTy2gmrpWD8fzfCeFtKP+qX6D/19OOhMWgjBP+aleLL/2JWQtAeaBBCePwQA8+vjwzqubtF4umq1qVrpk7AbHIc2T6lVrf7dsFmpUFUMCOe26YXUOv7GOVqUMBv7KtvYSXqWih5IdsfQcuglmUQxAW2MwARiETzfdP8rkz2pQcRGIhnMe3rvFWnNhf9A8vIvYk5634yza5ij7pqWQjm2vfZMYvF0d2BgmlXOVP6WKdACxhc+nHR8A0JyDi601c8Cetj4NrI+tb53Xh6Oilr1UOuAbffo36BNQf7AhqGWoYhiAdsZwDy09O2Nlc9Lr00vPS4KLd9MY+0aa9hbiEe4Ygib0qp5+wO1icMGQ7ExRq4bgMlZNjOHj2uPDc897j8+BacuOU8XXxT4FfDjElPFTFKe4eAKHYXiueSglgWuwWmXuulGtlc3Jrr2J2oXP8to8ud50F1qJOvz/KlH4sT1SohYVGstu8ie/IUxknQAi7OQoybu5rR5W2MCaC0HjtGgr5AFgis3CIBvlso2w8MLTgF0huOGkA6tvJ+toDBmkLGUGPlyjhtohR+IgS5LdptYeh9FF9fPa2r68PgCzQEAeEn/QAO+hHdjHWIOKO/8eL3YDR0BBqA0JEB1H+vFL0ngH44MawwocRwy4w6mDUfnZ/2lFd7+0uW6pZB0HtoGWRzTXIFsf0kF/Fs32UbBse9CBugxZCttm4NGSoNeNbpHWjTqYGGcOC/tnJlMiSDvhZBQtlmCDoMLYdGJaThs/6mwnMEYqvV835qd+zO+zfQnzu2463vunlzf+m2787/v2Ag7//2fT+0jt88t+70VP1Zf7LZ48ms+Qtu95i2D/CJFq8nM8H+2adU3KYtKQOxTgW1u+7nalcXlxVsv1u0udmpYFDenZzRhH0QvTUSXP5tpxvFvbsSLjfDx+fK/5i0pNzp3G4v3ko/ZNtnRqSOoIQX2DKtsT48V40zCc935gaq49vadflqTN3Ny9raRJzKNfEzbaxGtGvOKzT9OfL03lmqEhd7urU0Kl4JS5fbelEHF8fQNLaVNrTgiFSe5B+Mj5azkMkGq4IOg6k/huQTjjNCqjKDcUefL8TmSssCaZZZJgOdqMhJbIxmeNE9e4gVIoY5r7Np633VHO0gTIwQatMe5q2v4ke0hmZULiGJKhVcutaY3I2me9G9a8lqAb5aUlm07FRmr3pRGEDOdV67chUE/YJWQihTo7XUszPsZcyeYLNc4/Jd42KWB8fseWkJA+nUtz+HIWgHNAQ9X9v07n3Dum0/m9p+7hkZyrC7cHGacu8OVU/Htkz1GmA9e9KPG1e2PaxJgUk0K8hWErAikGQZgjO2K9wZowr5fTsmzfEO8zVNlcKPb88ImGTSbICy1zUHchv+KoNLFoCfpmwIG9pWsBsagD7oOxq+DH9H6eGKDxLi2TNdeg8L5+Egz4Hxc272f+qdh0cHcHznv+xyPKDV0Pq8pVm5q2zy/dB8qH/uK1P/HvMIcHScMPzxy+zzXbYrkhcG5+M7wvCmK5zhBb6rE3ciyxNA3yAbQTNsCSGTjKCGM4ScFJwIg+WhDfwMuTpE5CLMS9r97sBX4Ids9UEksgqTLWGc7Coyvph/NihCAvdOXkhYmBURAXFiULJk2XmOuhCfXNptKovH5NSL73HBM2neQJ6j/8N35z9QEWUBOKG306qbCXGachxP3iijDhvL2AvaM+QJJe5ZYYsythZiFYGCSUjzFoNqb7ORtcds2cwuxOV65caAkGOdioKw0/CAptMBsNu7dv6CJ5XS6D2FdfwNc9QFccboelJkEc+IolZvL9eeaNOlbGoy70oDWLcceXVFnaZdThuqqGD3mzPk/FmxLIjKiy1O5AVSnUPatxgU+5pq0vd0mTcx8vE5LtrgqXLS8/136s/C4eneTqsFPdZVpV8Qo+ne3kPg4aedJfM0kq0Oba2A5+FODbXlxVQIExLTSrnxc8pM0qElmaVRfI+M0DhSXDmvFkVr3F9ZdNrSmX99TzNwwTl1bwhA7U/a1jFR775uAxrzFNOPTuyWHp5Vt4OSQ+G7+Gd6RVkiAw+smhZFL6cwuoxg/3sFiwKL4glySngER5HYh8l1IXvrJlRTMPxYclxGY1iediaOpySFeWYgLe75Nvk2bUEcPJwWymjRVHmI9O1RPl7qMje1jcZmdoAujqiiyqvn3Fc4VjkYVgg1M7JyNDNXCAz8DnSulGhi52TNHBLkZMj1DRW1pZ05MkN9ZU1Z193nISkpDhVWWU58JwTCJizsWKBvOCOoBAbq0QPoR5QYviqSyeslfEPsy+PJ0Sp3fHvjwlVPB9GYK92XMQPo4vP/UxBlAZDQx3nVjEE0cLUsJ7MYBAKLQSYzvUY3DG63vqHzOjGXMP3o3LX+518jgwTAxWaDekEmd+ufrJ1wv9UWLPDBl2MkxVEYwEzkGJS85LgHqTIkw4kWDaKeTerY2YzGLMbkhlHypqu2j5UsKFwXrh3puXcQjTHmXEFDU1mYHimetZLT1yEZYxboPvBfhT7Cn5iZJXkYc79vH0kxqZKQeHob5qptrTJVEiVxw0oNdEw5uubvYA85s6sPFDRbgoxjbO+aXY0qTWy3lg8AKwNNL7d5iGVTxqMB6kSlp2mssvDJvgomThE2pjL6a820jQ3KTGFDKrO/ro22uVHBl1tOVZae6+ytunqmtqPzpLHsTNfvFwoQK7etWby5I67IPTt0UcY2A1YVyJsQ1LHFoNrXtLD98Y16M1nnm4N9mjq6PgbzFDMQwzm3am+GOVrXhJ/jE5Xl2PQe2j0EQNRtVi9fEP2f+qqIJA/iTULt3yAL2p48bJoWq3HLC03Rg6GlcNhV4mAM5hlmQ8x3WUtlraJZThsCqztaIauIWDnal9eM8FZl8o2fdAxxFM1jwo7iJWjMDWeMc27X3gy40/JjCGCjnfFaz3eun+K1oyLZOp5flERNTSBsyI4wLRaG0+PDZdRMae38BF1Sseto1M9k8796oaDCBlZo4nJj1nBCJQGtMnk8PpebwS/powDmH7aYJkBKJ0zcMaJCp7qGMHSx5DyOXz3b95DLk20jurAN8WygLx+vB+moxGCOOJDDaMM89epWpvGjRK7Y1tr+/udzErCU8U7LvqMwnx3Zs/50FfdY5w8K9xuQn8I8jsVwvIeC2zC4LbiuSGS526ipE4UT4QCvw2c3jgBXipx0tWeGiMebI59wXOiEZM19GDFFhb9IiHwcDog5+U0Y3ApcY8QjZAO8ojkkK2/vWecGktwhvg6JE+KKkIya7d9Q1SG4jMMasNkge4Zsq/dQrMqvn22u+1LY8QQ/tpe7e8VSb9jKHqzBLqLiXWMnCifFFSN9hj7GVEkt2STAQgQdQ73/VpHU+4sQGh6V4k5ABFuHjx3tDv4h0+HAmrZPJWF9HgJyuCZN3EIIqIlu9KTQOYkJXBEf75efoM8vTk0EOY3XZe9xj8xikggsFpnEZhFYYIK/bws1LCJhF9gEIjssOZ1kT5/fR9Bid6L3BPDqhMbNnWDb61DvNNVpgcNiay5rHNdx8UWLtZyWNyZU38aJeXW+sB6j7XGJgC9LD6k6dy3RXMQZyM8XzT0p3GidWGydQaHq++y3QuJSoSi51pQsIDECncdyAbfW+KK6qwMdvn4J8/jawkuzIzhCtH8tr28SgcmIT+AJuVxcnSlfGwMcb2qxO9CH0bgdYFeIlNPEJHhzmK4JHLED9jYTxgNl3/AFeDwWLQUt4Dc91/Mg6ZjuIs8UVtg87arkGHLEWIU8JTk+7UphS1ixoLtEOiq44CA9z0s70BHtZb6sMlLzWqilRljR1GqK17v74A+wO7JBAAO2bpgA+KM6/j7GQb4ZsnEsK2ZiisCnBVaRQKc1tUuzHeT29seo9tnOjOI0AWKTNjW3vQjmU+T7JTlaSGFqXqtJqkOPIjcc+gu0ZlriqDZ+1wTJzESWFcgz8GTj2ICZlCyAtfhAlmdWHVcCazg5xHcPOW2pusCNgrRq+7ZGRoIZMCgpCvtPhPTG6fqXN2bP3LHv4uKwN1WZ38dOjLOtVg5bRYOMpScL6lQan5opzn4pBaU92TxxYKgkX5HHhFZohlp7Folk8am438nrr4eRS1lZNey+8KlxkXtRCDlRnSc0e6envwxSzZtx3Hc8A0a9jhFOK5Ff7jcLby4YvC3p3QarPX5HH71zqebX1g3jFMPqQ4gD6bKEKJYs/rjkfkzrnui8mweqfHYeN/O//BH2XVg7XrNvfe7b6W3pVzv7N4kBJU3b15n6f+f8yDeiZdVirnZK4YV8K1xaK7ZZ4Trv7to6wuWrtfH3Ny6YfW9dA+HS1fqE+xvAlkIzJm1lffifP5gvngT8fTyoEbhdTxOg5qZ93y6h96i7cIMw6TJOuFYIWo8DO1hIMRv9peP+ZvUsX12MJiScGYoyJTFVuDTlDJLEpOYmFc0RtaHakHMKkybLTaZll6V9jUsxfF5UWD4S5U6iS3GpU4YbyuLQuX2S3tDJqMUljOlqS932mxoA5bTN+IVPmRtc4HcsuutoTlnJ6pjOhIaeabV8CyG/FV7BcI66+OXatrJVcs2yskQ/I7vVvEhrqGmEy2sB3eKRNj18eTatii4z1BaWza8PmkJ19qovWbVCWlIwnZneKE5ltfXotMiClvFbU7MGKtr7z7nWblGVB8cFhwvDPG8j59Fh4ZLpXOX8siKFZXl0mR/AohTf1+EwdpjduBxpSMSLbs+DfsTVzsRwcQ94wl1VivQNiq5EeN6y6aT6hKr6M9Tzy+ixtS2a15TddsvT62xC4w/RjjcunlSwwOE+aa44sxTVmlqUuWVx+00WIJyoa+2OulgyrydnTcz55r6U65b6AmVzakp39vSO/rbYLA95GI806prENOaUUAp9yfqlQvWyurbikRNVXbPPziz61V+FuVy0d/PysRR6qjYJ8r/jHCf7l/n9cQ84QdgfYnMxEIQ8V9esFSinaep2bBmKCGqMap5cyiaVlCTx6/paswVcfRNtHnFeQpOSO6WkunnVOUWd5ZKgZqBMmNxcpplG53m9VgebVMQWhZBdY0lR51poTGOaKL2oiTmHNDexSZreqdPpF+1TgtuY1s7kc02zuzWLog7WTKHd7KzXyRtTky3KXEZzbVx6lMI1M5iPt4FSWNWaYpLWC1s0nKkaNjWV7Bsx9Mwdman92V8Se7R484blv/vBwhJO+mCPNmg6jQulcgd6dMHTGVx0hqIzK3V9VTWW25WtUFqyOOtM1ewNpfHAoVE7OEZcF/C3xuU8zVm2LPdZLpgaWe/wMzBlMcgk5anDSPGScCaRHh6ZEGBDy98qqrIEQrt/GGsqCJS88nCfZqB+yKF9MIB5TwIgbGkpOWiJzNxSQJy5La0u0VtDAF/lxFhKzzb74jV3mP36hmVc4cLu82uCYQ+X1TeaoYYvC/AffAkPfDAyLYJWsWkxachutFNysLdmCTlD2OR3Icu6nrlGBbCbrCxV4HmcujhOl8l78kR9o0KbDgIZnwZSs2T3tLpt8VnJBi9ZZFZJB5FVn8ISt7E4PboZa9AH7twh77rgRndf6pcP4EyTrkMJb/f3HzgFD7i/qyWSeiDMbtWQ0y6eq+SjrrnDVsSX9w4xhCyzbTV6rW49kgNtV7ZsuO6mvzbItpmEtiw6avu2e2qWkrmiRqKp8XYClT50fn1n/1U+WUwIbaL+oc0/JIB1neqfGa3Pi65iZ1Krm+OV2evF3PyVGLb4ZIhlQTR2N3Z5NGmR8V28dDotc4Z+MFresVElX6KXsuYv7ulIuGtmFc6QSZT5GmmxXBrhxSEK7Bd/OU6KJfU9Y2SkGeE5kFxoXsAuLuxlMU0cLELDzWofo3IAGDg2XwF7LQADpwXxu+7sdv0fY0Un0iNh5+bfwKbeske9daN62zHq7f+qd5yq3rldveti9e7pzPfswj4f5n4F6gf//PTfW8jfcHX3CeAd9h4EmgiAdMbzBT8BB/D+vJ9HRKigaFPTcYD/4cafu74KVtRksgVQD04aYxvdT/pEtzW6bXeT1sa6GzU31Ks6hdLG+rnlzH+2TfecbqCui1ZZY/1btcJm8yZqzJbM1YhN86yNuZQVwtfDebDd8hJ+DtaDbwC+/Yj2bW/c8Kd+vzzvBkAv4Yj5t5McHtus+dPozfe8P8+WV7RxBuhePenYu7Ezy+u+U9QxKktl9yBFbZ9ic0VNaeSy28qyo3KwUsLZuq539XY9SuHjOZxE+j3sErR2DFC2oEXG1FPIIq4ra5k2il/mU1RGi9cigionLIMEuVV0P+Q9eXwq1jQf2NXjWeUrfm0oU89quFM1CB4qYfEwaoAfxjrQYCUn4JQLHMvv/MZboNyCVV7ZAvwviQulYN6K31rinII8pjX9/NJ/is8dmphaFVtjCWY/+Sg/HR1XXxQ8uhuVx3t1GecNlk9rpiM1G6osglke2XqWS5LWUinESBpryKEVN0ox001ZVljN2v8x2HWl2NVxzq81vPoz9GC8Xa6gjFRejbDLZ1It/VE7zLaMgWnITIVcrGfVHtE1azvy7r6PdkA9KzxLx97t7GKPpWjPvP1rtjrCJ8Bhq7Cff7ZKcz9sVVzg3VbVcSFu1dmYssbeUenZSTCNr7YK6zOCVSSgrcaG8ZM51St/fnAz4/gVXbkK9YwKFTAwQejpvLdnvAILRPfgb+nUqmKkk0tLxwjhxKhcEZ38thtfqmZiUM6oCkKFbtUmFeK0tX2g8PrGquVBe0e5UhhfkoS0qusKlSsz68vnroPpfFwi+Fxz1zNfMj34KBTRKVCtRC4jrJaOjr6JExE+hngqdsfPEjHr0dO/FOIFZlaKqiEDCEZHPwsiY6ohv6K9UH6jrgTCy2aDsVYnlWkLV6BI+GQuQ9Hj0JoVuM2En+V15+aXAQAA) format("woff2");font-style:normal;font-weight:400;font-display:block}
@font-face{font-family:"News";src:url(data:font/woff2;base64,d09GMgABAAAAADHMABAAAAAAZOAAADFsAAEAAAAAAAAAAAAAAAAAAAAAAAAAAAAAGhYb1CwcegZgP1NUQVReAIFCEQgK4xTSXQE2AiQDg1wLgXAABCAFhQQHIAwHG6FaBdwYbtg4ABPmNyCKkiICTRRlkvPP6P9LAidj/Nbgai1AYysxyOAyrtmzR2ZDrBzK3IkCOptTRoNBsAYFXeQWUWduRtQEU760V+g7JV+H6Ig7Mw1uToGWlbz6b/7HptAinjlCY5/k+gB/rvcxIQzsB3LVFrcjElc+AOgkjod/Dn/3jQ/WpIUd73Q8WuN4NiZoQnkWch5gtN4AbbPbfmZgoSipIimgYCApKSEhSKVZWLHSibmodlVu++jpf8/tf9F8Bg/x1//O/O6+Fcso8SDIYswl3Dfz5Nm3h/O+vcmYD4AdoXUqpIw0aVNmSuYftVmRbzdJxpxZccuaFVRPGBGnJ7Un+Yb3qnkDZ0IF3eYsCDy2wCCkgH59+Dn/PUlukJtySpwC/7729QH3/QE74uJQzqg5NWGm5ln4udFD7EfbE1HM5V9q4CERIiGRGVInpheAPPC/5qd99/yds/OWwP9pWUa4L3tWqtAm53XyCvyB1SynnAKAbIUCWaGacsogAV2NqtC+Q2uWdidw9IWkxPsIwhZYmApZ4ZKZ7Ew2s3Mbom3+AHOU5Oj5iErIudzfE6EqoCOQ7wqqqvX1uqxboWRtXbUs/Nsy5YOz7GTeQVVk6sjM9No96b9eZj/fobt7dzXGGFVRURERUVFz/8U2g22d+E+0YqkH/O5fAQIgBAAAiUAKRyAAfG5CkPuf2W0hfvxqqIYYDYDNhgAQD9911eDCbh6N55YUIUdapBVAmfdI36Jmr25A+TzhBljkNnEqbieX9CjHCnj/fpYaUNtK5X3aS5+g/2A/ZSf4S9j17E3sFs6n3MjAn0RyUClvmt+e38ffw38pQIcSQqoF+wT7BL9dR1+2UbhDeEbkFh0S3RT9p3EkwZKoSFgkvy8uP+qPg2l+Q4IIi1jn1a1zuQr0kGATQOPXJgAHCoryeQHpMBhh/oibDDPBRzD0r+fUTqNpM3QQpjIWHJ5IauQyFFEntar0ikyfbP0fdMBGYV4xfnKxAoIo8e5KVJICB5Nkk4Tl5SrLg+PgBDgJToHT4Aw4m6QOLoCL4FIlHXAFXAXXwPUKBo1YBDkDj8ET8Ay8DfMQ6ynOpohtebvy9uUdyjuWR/hlBOAhGMAcLZHfJUFnpcA18DCNdQ13WT1k9xRskxXPTxRUlQJXcLz+PAO4h8qH7hFSgsB0ufu08oySLP5OJ4nLFFSSAPuTS+GlG5JJLtuQsKJcSnmMQoJiSSUMV2VwDA5DHasayTX/jlaD2qV0AkWRulF6afRjDFIZN92kmGkxs6abd0MhLxbw2DzN4HIrXTN+U7sNqSoqKip+VNEpDMePEFTkoYq3dk2UXrtKjMhSSI+hXYFf015hp1iyFFFUTq8wkWV4WngQ9rA4yKaN3E2g8rNQd8TOG/WS9kCEfLKKyX+QJYWxV1eZyGFRqerHcnnbOvSlZ3Ae16Yy4lnv5ILNspJxOl6kZHzK2rlhNrnIWhabKKESr0qqbaV6qxpxmtNbpbRz6zQsQrfppzKYedU8uwXvEdjZg3Nqouco22x22Ds4Lp1CGNkLBOLphElRLh/EI1d8nKfQSitcfWGXtB502+Clhdg5obMHDVF50T3ANIIFhyeSWuXuURqhTmox9OJMn2z1HCKCCsiwgxlXfzJoMSpjsncMwdFKkM6OUmPr57bBtTL64HajzRpt3k4L8IipWjvtnHXUXaiHcE/VbJuvvv3338EP8LMAEwV8fNoJr+mB265MLLmpn/MTliVSqu6S7ymzuBFwCXAbYpaQiGFZrrVkFP4gQdjB94rXM9aK1LgbzApqwdxsvx5Di8SUJ1fZSGMNlfBAQy0IXrb6zvysJSoHuslIOIHpcuvpYDmWxWmnJA+5L9W0dVKupdsr41PWvn8YItc+eV2F6oo1lHSVlVU6oUpTa6+6qkbrNCdbbdROpjMWpS6fr9cG/Y4atN24hSb1mpJmfnXe1m6mRc4olipW/PPn3bMmu2yr67a6aY878F7SExi85zmDbYhdiH2IQ4hjiFNuOmeWtEWvajZ7Sr6PWHjePIg6TRujgpFuEahl3tx2+2SWW4M7W7brXf6IeAARoIsfo6aGAT4+AB+RT4Geg4mZZO3phnkXbfGQ7uKii/mKGpTGA7Z12WHv4PjKU8MMXRmaW0yQcc9MitvxO/b1OsjxnU8N4Glgq7qOrxRG7uk9sHz65Pnmce2KB57UG0HJridGgos94gdFHbFxCqmEtcSBT0IkklplMB9FvbsWT49ghJhFimXsX8Kpxq2Nl5vfRrHkgiDx3pRIKywWSEb5EFLCcavX98hO63JWv2U3rPh861a7y+wh1FOQTcds72knewfHJ0gcxMpdpHc2WXfVTaK7uJ5XNbTCQDw0UxmMeHy1g61uRd/odSTeKFmiNOA27I6wEKsHRAk/xRlzvzk3dyX8Uvo/+jeApT/iwvBfuXppfY1XEMqEsjvXZ/dSP/pyLrj40u9SD+9FP4YPIwTcWKvXp4wpoxf6FtcFpnkhodFLHUxjg3QjVBryEl69guUmqqBHP+CNP3LZHde67U2Au4aZyCfJHE1QAR29MIn55Kjc+SzrO+UDdT95jFxX3gZyy8ALwzaI1HHZxM0jDhjQm8YrgGWhGLG4lpQWtjrzhfoc4UTDq13KmIbUxFriwCchEkmUpCppo1a9IKMWM1nG/mOcCtwW8AL5LRPrgQDs9q5ElBCc8KZFFmeJlnFWdBVaX3X5TKChXCfVw+3wS1aoS9+bfFRSq+b+oALCjkQ4HudJVg0sxeAAvuBvq3IqQ5SpONAtRuBzXdRVA7PI1AGhrAhJPb7WZXrX9Az4QhC0ODQ7IUI3jAlFKmAtceCTEImkVrkyJZQ6XQunBzHKM0uyjP1OThluo3jZ/EoXtddGg9PWcIp6+Zbeoo+Hjo6Fnp//6dXT0/KpAr8Iq59oUhoTAygHoCpkSwzy81EAev5hAdgADoAb8fAJKxFAvCKZX4rbAyVEsInPmjAQRzLhYJF+hYH4uB+Gk+UxYC90J8pKEjdIsJZDlXOuA0OVNlcZT5jmm8wlwtOfUG/mzZE2TSYkjJ5hLkwVNw9e0JQl6rQsS26SkOYb3y9t9jLS89eBguLs8Pe7v0dIRQN0enpNuEVK2cewWBIt0ZJ8clb4QRVXdbWsqyd1yk/Syb28rvRX6l15b3h9/v6P3U+RaFHiAAkMWNJYCNRqouCCJCIAiAGyGUMxbZSzzd5VG92QWp9uLXg0M3k1V9ycDoMT/28Zppu02KQDjPb9TWzTet1mcxfuMa2nBJte9Jzc1it22Ds4plO21gbI5w+FitYWkdaBbmLdxdj4Ziu0w97B8cQJTFU+fMUTTqFjeFWCPKrR6xJ/pGR7xJ7Am6jn3sFV5rkx4jIhJEvJCEucaAiW3f0GvegWfKhuA35GDrq9BimXFj9fbwGD+HnbxxhPULkIyetgHb0uNxgzeyINozqhWJlWVncDuQ04iURMONxKuHXwacd1CohidFnpZYw8ZcREq0yiTZVm/u7np6fSqFzaaUh1AgzWO7specH8zoiN0Nm7XRVWVqiqWEXFUhV1zdSeSx1romq6/o37Nax7xrayHdHewbE79jhtHN24bOiZrjnuPq465/5XeZqKChTKyGEUvT9NzpQ0QczAFxk77B0cawW/MYqw9KjbzOqis2NyIcWwljjwSYhEUqucnJKLOl3LQ8/KSGCWZBm7cpvO6zu8O2TGsry3QiFMMVw5zRVEqtO/ehCEosRON/RiRQxsBPgI771M0cHewfHSAyQ/oZYFBWd4rnkqVW+sWgDWChByR/G5MHpdnM6SLQsLKwsIxsDOgaFPoFA8YOD4CUu+FdVlJ1zf/TbYY5SNmFwul5vctu4h2nfyUXXLMCsuv5uRr428MOh69awBqhAajIcQIPfnY3jGeTAoKjpID/xIflGYRLA30YJA+CHIgEQQgaHuT+vnNihEfPV+5+c7gzbVZeddL99GTvnNVmQnewfHdLqPM+ZxLuU6D/uDw4sqqqDUiqwiVEsAKqBcxH0mzoJCBaDQgO4tAsJmboh8X59BlHElkzKm8Wbh5t23ZFtRXXbf9eptNYmVlZWVlQ9g+DIqRjEyMS3SNjbrDJUB3RlMAhYcnkhqlTtISaB2w85JPZ5pyiCUpAh4TZrsuyIZd0snyJjs6wkJcnDp/eAL7zkhnc8Pl2PgrouPbhO9YVLSlDTz1bzVFtVlq133Y/4sk0fwMa8twQ57B8fupeisOqoiun5MGFY4PJHUKtdJCaNWWhC9MsPY/SCGRbhFTeFgt+OHDl/D4OXSgzo7eh1q0NAPG6pe4yBKNJMO+fT13M9OOZcvobvujruDuXXybMRyGSt693Ss/evCd3Nsg6dQ7BsNnkabY3J8bxGqXrQlBgIzCcvXnRMDTnEA1AjK4BqAwG3OlmrU67gkyIcAAiCnzrc6L9mhOHANPBIfS1xx45uGZVvZ0ftFYP5Tt2jKQ0mAmOKw7bUVSuADfjh7oZBiT5R617BTDetS2epdiIkvc/T/0rUiZ0M1U63Zn52B4PyQvi1YpGlCoDUNAjSCjXfWJuRTQYbawhG4fHRFIAPQMTzQASAapRdK54Qb7pXUCOZ/92f6s2FqMc5ToSfQnacrOiPFVKpSuUofhJBY6cxSPCeobRUqRRGQV1rpDsYt9BMUr8hktKSW9DBnQqGz3pAZ64PpUSVjgPiCZXGZmXdKAosUjokmQM5CDNVKpIiwK0YFaNSS1MvJ7XXtwBnDciyUFFynOHwOKgE2UvFg7FENBrQJ55IPwRNFshaVdGTnamI7mVj6bExBUesP3yOvvbizv8vSl30PTW1e8ZTQn5BQb/8IeU0CWt3G5kLTGl0Z2gZdoSmkHjj874hkctAl9UOS2nP4bizYVCwBVC7DNff/GOL5v//SuoFVbRTJQBrExipUAao0JLZfimcTbaSivqGukAhi1Wo16VWDSkBkyq7fqvZ4zVal7IpFas+z8nnUjImtEEeAhnXPCmZeOQVjEMgHREYnQr68SZTbbNgJt8UYtbVLI9qHmpPLriYVMimRwhrrspGCpQv1RSf7AhoKKv7eOU7RQjHnTNdLxev9loUFdVyBQffKtdwnsmRY2YEo9dvBIQvBQAxBE0l3RokutN+hYmhRD72lIl8V8i5Mx6BYrKX56HiU7qbKx5Xxtc2t19qQYBpyMPnvKmgRLiMU63Is5r2OQj9CYHEqhzs6E3bVDsKBkxIBRyhdtSQwQLyxU/2VVLJ0V+hAWdU9rwvEozPTA1Pb575P+sEDJ5dtRkitpBrshlfVB0fjSmlqQEN3wz9IANq2EC1sMnSwQ4kVoZ0aArsC2vHEry/U/sDyNpeUnoXs3hceLJL8PAxkqOnPQDs/mRINqMvWCXQy93HgZj2djyuDXMJQw7KoaaoGY0sV8TOmG3ewD1inwAkygXTNhM4W/3RNakfTJM/SmdqaC+GKVqBjnI0aqCze6eiUJwlx0M9ZAa+WQXPyqlTQwu37qdloWRxq4Jk5vE7tACUsOwYwFRSSHXmw3sML1bVJwPuFSot6xcT0uV72QaXHGEX5ry6zgEFKlaB2uDRygp0aPsA2DPaWUnzhbTFJyVE1oeW6R5LCckJi2XfGeDHFhprac6SlkDogs5hB2WGUjDlC4zL6cKOBSStfPaYp3S4UkpAGIvL3bJ3QUD/zQEsuafF+h8pwN5ERV3lG2fb+YQG94wzag2C7MCJn2+Y2Q33ZC4N1xwo8QDPYvUnvRcgB/WQkdiZCSVZTRrSrdOV3pD6kWjtTYKaS6ZG6w8XqgcxEG6GjNckcDAg0Qzo/t3jCNtoj8pGDkCzLWmoDz5yxFRLK8oiMmIcH8ibzjHNCgBntAkxsEvpnOH9OyRp+BXyCkQv8872k/A8y8CzM73WBX9FJvoORR8QyzRGQPUahbwzCUK0QlWBbigU/Eq9j9zJVOQ/dXtlWjA8FxHamHOzncMnGxFh6HjAu0TDZMq1XAD+jfkH3bmo9WTAUMk+S/qGensb+38S4RFgkpATsyYkoKdlT03Kg50vOXxA3IUJ4CRPOW5Q4vhIlC5IqTSgjo3C1GkUgEBr5IQASDBpgh43NmTt7gBQAAA5EVLgANYBPgwQ48sLiTUaAQ8yVjoAAxQcgp6DHAzgBhJQAQMuTJy0XAODGly8A8OACcJHCHDre3039+lywjPJ3GKgeeECEAtQ/hok5YgNkAAEVGkCikSSk7PBo2bHHxUXionE5UOAAlAAhDQCQYzDk1ABAx5kzAHCiBqglWfLQ+D8VveDjT0kepXMvLkIEY/3ZaNcuvDSgOHPTCLyneqRYe9S7qaOePM6LM7r+zYsFrKXetJAZ+V27Tu4zJL4BKZ2dslCWC3MqBmM2VawDz3vgraQDNR7U1cTpGRR81FMwvxTAD/nyW9+HIIDmm9IGAiD+u3oqQRewqXlo+gAZfEgBEkAQoESTISYmwcYGedQIvWN0SuStQdsAkJOisAWKlqSznvoYYOeHI6OyPQEwgsRI1kWevmOtg+TqfT+Dtr1gmwwPPRDkgBBAHCAVYAIAhHjJWmmtTJMkGTKZlYsSJ1aKGNGsKtVIYJHFIFu1dBFypMpVJY0RgRgbCQBoBgDvAcwF8Tco3gFjAJMAAACQSAQSrX+4w4dkg9Z6M6ABiVdyV/sgRI1trZlNh3itsZMt9ipsa5KJLFlIO1yM7khr9JGA6LOMitAIBEFMx0h9omz5uKVIoi15jhOTik5NGhtC2ogZhucMvVRx3iNN27JGUVLTilLDe2NqWV613ZiR+HDw3AmTJfJLBut5mqwkIDN0OQJdua4gDIf6h46j7BOSWWFsVlrqeduybta4oP78FpmQ6vzUfDKo3dmITRiFMrNINzDBZZ4BccKwi3oaoiDnZmP6pGv3wYNQEjsZDp1XWyPCUh+BBDYXX3lTIf9sph+2//n+UebFkAsWX3azpZBu1UZmPil2XYTN3DAMu0FPI9Q/TEeyjLD8e3LLnBfBqAybtG6dQNNaEWeoY3gtSEKcgnUszoSAI16o3rcAbPcEi0CYWcqu01obbsN0SAgQNfU/OvqUPONiNp+9qodvHwz/rSezNNzKkDuv1+vH+AL7FVUkm9YK5k8LUv5cQ4x4nmQJYpfmKjWutpjHZm/6OX6mtWC9ouhnm4wH+AN66HbcAMt6HkUluVxRqKPxGwemyP/HWlzj9exgdekNie0l9MkOBkiBcKEP7pmmZ3zLpyrskz88fuzZO20O+iQM42z4Di6R/Agrzss23b2g2tAd8z8BgmuHaWWoLKWhiNk8ONJhw2qT7GhTOAoGWBUjwX/h2RQ45xC7JcvrJFB+CvMhcPqlBZ3NTfnKqqgsqNz4y/JbNhK9p4JJsr/NQ0WMimRB1F4lmJVmUH6kHp65i7pzkDtt6aFP5UU9UUyENnI5+SYebJ7EWgLYB5QWYLKqNpVO3bs32qhLSgVqmJZeuLIZlMFcHuSfBcoX5J6ZAsaf8zqaYZyw1Jr62zWsRhrqInXhxDb2zcW2Ble6/349lOy+RxiFZkVAKQ/zk7pxZ50OSyTEfY32s1Om8edcsBIApc7de+fHpntfq8q0zjNnuoOAzctVqMW1KH8goiAuohKww5nSrV+WeVvPlbs4y1MILKQgRyBjTC0vuYkHSxYZyO+eUbX/8IWqjY+BbeNuIWrhYlq/rqg5ZGAJJFmUvP5e3Nr7JmggTSCESRWCFFemVUFpmg1FQ3vzSILJLqyThSsuIBpqVnvBvnb93i0zvG7cne6zLuT1fQdalEC5SWqDDl4QLBg6OXBgT6XunUtHw7jtzVEiFIrLAntqUcXScR6uupW3QymrO6030nTgAOaDpYI3stZkp9m61NkGrpkGamhQYtttbrfLY44iVog7L066iNuqz0PJfn/Tt74owVOt8w7b1T75kp4orc/b+tVRvHL03G8B5j3dr10w79y+CKIILY8xgniXHWrByoyqSXhAxVVcvueAhhTJTi/YbFxaULNv8WH2MEFiag/Ef+ajR6GkrR7iEmt/aeXpRfLuGcifrsIkW7VKV4x9G+CJJx+O+T13Zfl7H3AXDFbgZnweR+5hlkMtbZAbIb9UULlv1+KA2DrqwcX8ioN7ER3Eqtl6RlVdHXYU/dUEv48c7t/d93WWW7Us6apib78e5cryjmSlvhYVVUBbZdU6xhmtqgHrFfZGVdSieffl+7DH+sTihVx4r+u+d85h/mwnVNaAj5TuhHRdPsCXDlf9ig6DTrBHXQ8HFrzHQtx9+jZ3h3ZK2tZ1S9hMEImxUDDbaweQ5H+4w1KAV8wBwUw+BVdTsQ1eJBhxGWUJXm7x7HRIszMhgxTR0dDK1nSCI4PfETA0KNltre8Iq/0CQGHQJf2R1DFMkVWIt4Pnxg7LiF41BcAGRzAuwcKXAaGKGrpq1tSY5EShpDfmANxQT4raLWz9NsRZ8TjG5aK8WxBbJSw2e8YqT8WCeFY5ayxYjtYKE1eJmmHV5B6h535eKfj035KTls3WwG/gdzQ5rDH+yTOQi1v/SZMW7gM0Og6peK5ntoQ7KZkgHB0d1JFZPbyvy7BHjA5aDMNXpGG64GuISz3TdoNgkEE7MhhW8bMU8Ozb5EZYkY7BcH1M3dOvHllzrEKox+jK022siNFkG6uLRwjA+pQK61ryWTiRbmoSFtV+bJQl6QgZM8j++yJtFghDYMx7+NHjEZ/QagvXAZmKH+lxfDwb5h9r9+PT/Z8QmM3NaJ5kNM6ZzIGddm28u8H0l8dJo/MJmL/pHlFcYlqBEBQ+seLym+f17eTk/qetO8OJbsc4O+g8QlzWVfHyxihEbCT6Sr8FUsuoN1uPy5uZwyuYXdgDvSEfKK8XHSetGN283hwux/u7ZZDZP7UZo/PNzF3A5EsYacRkCI1qk3n5dhQgl6/x7QM5O86dAxmItgbHwSVcXVMg51aEuvhbCV71KJtWIXGpQYcbTWBmqIoJM0FSNdpforhDbRbVbfvlaGHSUbRqlKJl2bT9ClqvYc0DUOY+XPJ8Bs7jjaP/WvcUaf2i1/ek6qun+3G+O0vnMP7NxTTckHMUs7TOtweTE/v/S4hfnqaakZ6pYnYbz6LdedTdHTQ+Pmj6jLqWrk//HLzSArGQVl/R2fY36JorBwugFrprRiYfLacRS+wZoublYyE/0BMXTfE/HMwGWD8MFRDuaYuqc6XQh16VNwJ6h7/aM6v0337tm40RrebmugMdjj95R8ugls/zszJPCAirkMaeBeGKlc0XCr/pM8vx/jXXKulsIhBhmeRj7urpOcN6tHrEeXHRtOYXJzPweVRz/+PDJzrwrx7rB3xvcbJEx66ewPiSVWf5eb4VeCCV8/J5qzDIuzd7U81VLWSI9CQ9GhGoiptNtcypktF06McbtP9Y/BZOJJvuKK/IzCsABnu39C0JrbSTKWWJcDo6b1PbflCamEFJm8D4bvn24eNi1xqYBv74J3ogqYuwVFq/+tbhb8u5Fu8Qh+nMXMgm9M5Y2Z3AvmGvds+q/Xde+24jSL7db93yHeO11o21Bmnq/1K4dqTtfOHXfebYP7juQktvimUi2UJkVU1gfLd9+3BxiFG9aeJfLLc+qWLZbW/rplxpwDaQbLHPDru2kTUaC4MMfegbjdnbheS3axFt0ex5JQcMwPNqV6U/2PNul09Zzm296UYvMeK1tHppF/bDZBfVo1dqK2Yqn8c/epUXAvh9K/spr8KKie9uT1MXsFItViAdcUONsK/D+Kb7duPBsb0zVF8Hzop9MZRH+7Rh+b/mCQKUZzkYS/StJUXFrsxZbizjcc0fRMYO4ScwS3M/J4pLUP6Vq5v+1Q00X7dbEjzol+4FeUsZEP10/soX55SbclY5akelR7NuVxw1n3N183gEfdvEfDdK/Pf4z25tf60Zse+Hwf0/rq76W7y543XZSG7Q1xbog5oxrF1L6VfyadZukqMQbaZOnRMrh8vckiPru75gj/WALHBxqt+nB3+uLvXKujO3WdV9V1ndK/5v2oN7eyIlO2OOqX81BDspZXHaZS0to/woYQCeYUqysVJu+cD+EYSzX9cvVKhmbfpO83o/Z3Ps6BF6iUdb4zxxt3ZSIDuJEgZk6MOF4X+FMfyZmWEy2sJudOJfZhQeLRzCspItgh64b2e68uCHzX7llsF8Vr1cpjD201lQVlqjijvg7Bm47qtaXuEFl8DCjNHTKvyD9gJK7xGeZri8JN9mYFRj//jBmpVbq6ivO75onyXuBQkhnBVrOkAN92gUAaDiPPikQvGtt2nnyTS1hh95q7N0SpNmukmBZTx03Bk3v6FYNuk06b0q7dxG3drai/zxg1kTL/4/i/HNWdqHC//ZJB8/9sUb64yjX7cm/Rp95Zt7iNzr4+3P+3FLd31zGL9HRdFYhGMUs7R2aS+GvOd/uYY9z2fwb5bd34JHx/4lpxYWMWOym88o/B797CPev39/Du/H0ZEI5DH5W482alIA36qCjHV43zrfruzR6uG/PntxvvU+Tgm1Q/Qt7MAv2aNjZ498B7G3Ht0PGRlPVBnATP5xCrUW7duaqdox48P3n/b/H+InH73eO4Lx3fTtR39WD8Day58TIL4s6/8qRLV7C7SUXDrHX/iqouNyKO7KCXh5AQAi10mjZW29W93lZUh0nhqNL+dL8y9WnvduOqw3skpJn8o/+YMXDWlrvdI9WRsoBCMaWcdqbXJuTilzFLRDYJG7MwWI8gR7btCThl57dUy8E/AxTwVztIxCZh61ketslk5jt5dwaTwaSpmpEoot+XXBAVsbcZt/P90HIYOjYvqxwrbRqX4uze4YtLvod6s2rBveKVa2DAzUQEKYUwD998GFTr1wNvOcvoan4WEVMLkcWUwnNVSNtNNE7f0joyPS52tOnre5LVYZBZ1PiNR0duYCv/Gf/IMXryyvm5Dvw2zKIZrQaVqsRW6sEQ/Ecu9/CvE8e6cvjZSUNCPRwgf1HGtiJ+uk0fL2/q2V2vKIxNXzZQWXqy5NbTpqNJVfEuRPwfxMK7CwxHWkNUleZo1SIyCooBIZgs8gtVQOe3IkpS2FRR26atLNbgs7WyYZErGBlKXMxsA17z7t8e/J6EY+pMQVSbMkE4FFSk7t+hLgxCSFqnND1cVK1O1yu6H9m0UarYaTg0zABAVE8fyS0MIMVmXh1eSZ4DbZqXvGnn7qGSF2wkTp6TZSpU7NV6cL6zjCdaBqICf6lcMDY5Q4qpEtCergmETp8XZQnN+2RxF7PYrhRUxceVItg09iZKN4MDorcOC54ZGZH9BLnPlkd7G8aKq2cZxRWk4hVXBK6W+cBi8zADnq2AKpKshVUxky/U56ZwRfHCtb3qlVZWdx0NQieT/WbOnEF5Rg0nVSbFeGMk4Wo8hLZkKxZK6NzI5s5QayQ6FR/26TQ5kx3chRBdVCp1Od1cJNmcDTF8Wvx+MffYWsScabFhx9bysRr66abazrpBeVcUQF0FgF513/RIIySU9ZYIssfYZKJJ7xrPIGdNOlKDAOQ+lSdE67bwK55JCHbyM1EDP93xUlPbtd7nQMRjEf+tMEpo235vzxVNSqW+dC4vIsoMd82JOBHjmMIiLstzqP3P+hHE54YNGXbR/E2Us5feLviwM2LpuJzypODTrbe9XncXA2lKPgrIe3RsDTX6F9qpkeHltc1l5RTSBBUo+7AcTijKRfZ8fif/m1tH6Ax1NJkU2HGJ7Wwxs9SjMUTzmelaE5lhbKu/GFXRxXgrBw6owd7xVull3ILjfExC2YUvQEptrpUGLSoU1FFep3ANWeX/SeP057U0lJicOcH0Ic+VdA+mgXkLlDkJimTDJQFthiS5+hAolnPvPcQG48EAVOQWc3lNSvts8h3MrgqYsted3UEHBYJqmxtHbSfBNay3/hffrfCn/aWwDmcSSvUNXW9iYiPYaUA+oaAwyexp0OnRGFL2UVkeHxuiIQZ1l+RbXXobaiiAoumwYDaXsArZHvXQ/uWRair9nW2tLFZOWtbvt816GHdDw9i9J9+bRqIHMMwO4N13TymcOmDuH9oaOn7BXqLj5rxBhSvh1eKIf/6Wyqna1sok/D9sjMRXo21VH9JC03MgwAM+WAKTyHIRKRnHRDrWBd5g65nCqiZyixckmxg1SzOAnnrX55FP/PJ//M4GOHZpbRpJcIzOPg/kFVWzrqsgvAglmLLYHRMbChh0erd4xbneT5HuuGBncIy4tHSEDPTMRW0k5c3zntVKpgmX3lVzcLVUtvrrXPgtWqAKR1OLElYDjwm2vvA8bg/xVR7NdQvpw7vHu/R1JU2IFB5NSkBDAf35sL17CJfC3Pw5hIkMlDvLB+9cGG/fsLU3ACyFFsqj6XZyLkSxP4CAG3ZZhtKtbC3vdIbJ+FbLraPylLzuMU5Ca00vhEYn5ZogQlUbVPcQ1SWwaBhQJ3PAW48KQItTi0fXMOszonMPojIYiP1SuTJ/AsfWWZWJaOxLLp4BBBS/hg4BiQlVXvAETDnfvdZfpUvJjLpkFB5eM3l20O1qfaGBCKxNjnqkETcPaF+5Km2QhVMCyzmtM46LqIbC4LnZDUu5TCyxNsOYmf1fbdr2FSjQC19JUh/tPq0xO7D1r0GptKmBVxXrEigPIWgnkc+j8QmaBaQdcnZcfYnMivBhY2hqPjcHlNxa4G6Qh2kIzK+tA1LFeQi6HRJQAhpmHNxRFVaQRqPD23qtjYKBzJHCTRrE2UIomVrad+Wnx61Z5tFpWghC5M2jYdLwtBGsoG9DIdEiNQyUUUEOPE//9Mvea3xLejFJZw5J70nDqL6RCkGgjfn3Lyl3tioyAFnXcMgwClJIYqNl03CWKCWIZLgyeI+19c/jVFCPlVeDwL7g9JDCF8ermOH5vIYh0JdmCvdo6Xk4gJYdaBG3Zwq4MROiO2OTC9r2zCnE+O/49lnZpo9IYq68X6XC1QE/KrU5MzzigVQ7Pi/c5tvQf7OFCW8vOgJWZX2s+JZ0BDDSEsm4mDgghW9m6VqNH9IaMF8gIT1ai+5M+4mMQh4qz4aPU7vMa2+Xefn7GXi5gcCgYFDxxYe+EpCNUgHZwCVoae7hkgNbVbHAicS94mJamXF9G0tp4XnAROQEUM9814RJ+azmuWfVftHAatnmO0VgnRXD8g/BGHfYwcewNj3M20SgNaCgVPg0fC3NCf+BJeRlNgFcraSU8DB+g66asMmaqh45Me+uL1itqpaaQs3CVuyEpHMBnpGOKBu2JmOnD02QZ/ymSl/zS7gnQUyw5rbnebGz59H8yQGzz6jgKefkTC1FaoAechj1I30rYlitmxYtQ2+EboKNgTZxhDzxbSyalp3A/BC10kt8Mw/1qM/KXVsoZa6SxYW9ps3v9QecRfX1lRQsE7dwQeClF3mNnEGh27iCZKgB5IRIykQfdWQIBw2zQNysXGMGEpN9pcDEYm3vPF/sVIZ/Zt96zLB6LYVbJjr+denzsGROTdNvXNWzSBaA1E8m1AmT/i85YaIoH+PwiTDaGXnZKuM3ABwmLlyiNfU7pQpPQdRaF92pE4fhuuhnYNfFTqhrxtvjDx8BGwbDow6fGBI1+Ru9OZJrsyvnglrpp2XXNY7qrmbgYg/Tt1rmdTgiQ8+fbD8HgJgKMMrhy6Mf71xAXHiRTLP0lSH7gEkgT38hr/aKtO75kIruGEpnYOtHK0ZbGixcjG6K4odiyve6gy0RV2UsNAZqAGsqdRQ2g8hoVJbw/QSazNUnzWStoEpi8jU8MABkvixYpl15O169+PKQnt5Tb90VXK1Vk5IXEDrNzyshjRr5Im+84SJ6a4d7giofXfw0klTjpykDSFHMrCZ5VTctvjdeE6GR6jm8zq/fVRxgT+wS90PP18quHsxY+3I1/Ut//9A3K5H9tMYADZjcgSr7JhA+ujrnzaqb41n8hmHYp3fT436RNJRw+N/icZO2Y5Cb2T2Z2WYqC+3e4ZfnSBNfNMyjszdRknA22eNQ3zX2V41/+1eMzw47yzt+ylDRaRCBJWvCvEkWWrWamVyuAopU1r5WbvNezuXbW1tCxfQPqr6MhiOrWm2NjKW5sxloc+hIKV5egtsoF4segFVDPrnY9lROvSiNOAvGbGMeOSrFQ1zmguFX7IvNthun3aHftrmNZeLvxgMZmp9TVbbar5iS56YPP35bc/bupTvc1ecfPrAJ875IgROG+h97sZ2AT7H1/Jb9bfB6K4/KxFU8es26beNyNzE4YdSJD0nx4YjJcMAlOPQdX3FIAioPw7xjG/Pqtk6slleZCLLe30kdxWkajdJqOv7ag8ldfcuh0rF+Mwy1AQDiJWBedbVzH4raV8cVl7/gi1XSLucdhE+8c9b7P7t+3ClZZgUysdSRAlAqlCANGkvYyQnI9/fXnENS2RjeqLM/vt4ycOD9W964nQaK4sviaeX52mBe94739fQ/chr6A5xYpz1XfUNZ8bAibGCvqptkrqrL5mqMobbuavMI4FX1Ebu5Vqc5WjYmMTxvsgrbN91z6p3TkiYHmEFt3ag6Y2CL5mmTeN51G55adnhz8WDrDNwEvZeLQ5A7LdDHBSgVzO+1INcdebd9BXwNYdoLi8wcHGhOa/V+Pui96cJgBp5EtR7y+NV69NvaiqdeM72B3aq9tX3uP1GTkpK0abM1KO9URw9CTparLLRhsto6ItFarz3HVJYGrHclTVacB4tj2K+xEFN/v+XMf75C+rD3RuaTButunPdmorW/upHeCm3KAyY36vvCHbFUdwrxSwuiWN0htr181JHS0HdPpL61pzHg/78um8aRUgX9grjj3/W1DfGnAp+HnrCBXlVO6ej94CvCdubUPsutxTVulqkHbn86sFfLqrQv7stdEgU+Brhd1tpxYtE3pPS0xrDWbb3oXulTB3Z/LWSuGoTJpX31ygMXmLZO1KAcNVqXi6pEsSyDFubo3z6A3nqIZZkahL4KraecMNNj6S+xEFP/vBnOcD8hfWgaz1rSxx+ZhKvr2m2dM+SK1KqKGsbuHTOqSVRAuIUDElLFljdPOP9vcd4tp6zthMl4dbKE+Gf/Fs3rwKWDITp2AX11OGk1dSWecQHydweHXk+fhlT6GGRHSWaPIv1uxYbzfkl7+oCyKALLmKX8vWAJyyBw+Mjx5Att4Hl98Hlr1fApcvAdGTmCSV1GxCkimijN85XngKpyieZUxSS00m1Cgik5HDycQd1lUCCyAgXkq/mVyJeNO56xsNpte2n6wC6/+dGy8vOrkVVgfkNnzevmmbMi9Bt3MLFP0/m84mmj6IBoqKKaDBNPGWubiuS+d8+fPkn0XCl8k1sj9vC7fu6aJnnLQCUZsJ3hjIHASWTuMgsBuTGXP2pcOFsnT0q+D9MpSb0KW7MTx0hO1OVhso40K/tcakhMeuxIH83z4XturWuZFY8rXzoEfD5/giu7KVIxwD1QIiRUOoOjJUfdUvde/Y0489I2i6+OKM8oZ6P0dmSjaIhxNXHfRz2ZGrnvH9v9AlCfq5gLpZK123f79YzzSn7fNWla8vyyfl25HK+OzdEe8BQKQ28ySQnFG9OnUZuwlOlWBw/9D2s/N5boJs/Z1IkikbTygwVl2sHBUPBZ+uD3/f1NkSP9Mp0MH8Jy/0PTpX2keneglENlXL9YPu6UBdraSygvE6UOKx55O8Pji8n+NgaomBgrSv9wj4G5TrEQLPboVsylyc2e9sOeNei+UkNxPGLm+kDm6hWCBSVdCzXQVUWKP/pbtnc6/GXfj+10xbrB7jNG88oqzXt9PyHUylfNX5zi0MNmhd9kw3ZXVxxcq+VepTNI1i/Ql5r3gftGasxhr//sH9O2jjhj2/AI7I+ArwkATgSIqwzKf9739SO4tVEB2wdWsc07rvpPXYSOu5m5b3k5Z/nKBgHTgK7bQDRQaNWbwNnkrzTIu0kt/XWkleeu7zVCHcehwVc3bHAwCQUl6bfsIExGdzyMfTKhyrorqNafXvm2ncCA1hivqMVwz0x5gYJ7aHHTFcJty+05V53raQ1RUP6NfpJDQWPBqrWdb58ukVBmBdT6Eijdp5umk3LV2c35gLt3xg00ZbL6ldORcBIBy/vHJJb5LE/XPf4rQAcOdZ6cM8fdeDPjVBeWwgsZGwSvjdVhvna5P7yzB1vSyQlqa5XiqMy8A62H79eMlpY9FcXLYfwvWfi9ljweHY7uWcZcu8a8c65hqmcnXZvXNug/PYkp6XEx8Y93GrdoyO/cUt1hGHWL6+cnBBssw7cpT+0vMbqbs0tVq7/Cq+ntCWWnyWvOeWcafGJbbPGEmJ/61qF7vkwWnxX2yHia0Rkut3be4X0ZRSbO7Cyf4GNA+JtU7SIrS+ls+vpfbsjsrYb/UsboPteVzcDemw+xLQxGF2uVFNqnhUfxvihufEgHDMLeFYfuvKD5ETXzpTz+WVyKYfRl480ZDeuqb3rsp++yEHrjmbpWfTFlaP8LvUqrtKMRKjvlZzYcYT2swaxzAoFen7t+ti+a2i60BUA8puIqqrG+04A2u3cfp62e0jNM+5hkXPtZNrYfMwGrTV6GwIb7Ed79j33DYGSzxuIeiYcLorQACaVVvFqMsREqX2fqEZm3GaB2AHPPUheNnRhyR0vw/F5HUfWkSE9GFRR2lvtpAYMgQBCGNbHwLKOMRoTAh9+ODGzeUTQxwPGVjV6K1OmRKlGjBCBH35GG0HoEjMfRQ0q1dnvjyF4uswLD6r8kAL6qafrFGDUlZ16jG88LpuUCNGoEAlys6n1yhfgAJWVQLVoBxeqJEvY1Ut9h7feJHAxh3xpvPYwSLUaNiIGTow81QqUyBYgCBBQsWyaM0sVSwSfiS5lT80TevWzBNtX8bq+2vBkGlqAqADFouaz+EhfPcx2nixT8OVA7ZWpETjR5anDgW2D2Aj9JSid4Vt+B89HgAAAA==) format("woff2");font-style:italic;font-weight:400;font-display:block}
:root{
  --black:#000; --deep:#010719; --navy:#0c1a33; --royal:#113984; --royal2:#00246c;
  --orange:#ff7b22; --orange2:#ff9a52; --peach:#ffd8bf; --ice:#bedbfb;
  --text:#fff; --muted:rgba(255,255,255,.62); --line:rgba(255,255,255,.12);
  --low:#ff3d3d;
  --serif:"News",Georgia,"Times New Roman",serif;
  --sans:"Segoe UI",Roboto,"Helvetica Neue",Arial,system-ui,sans-serif;
}
*{box-sizing:border-box;margin:0}
body{background:var(--black);color:var(--text);font-family:var(--sans);-webkit-font-smoothing:antialiased;min-height:100vh}
.num{font-variant-numeric:lining-nums tabular-nums}

/* ---- top bar, like the website ---- */
.bar{position:sticky;top:0;z-index:5;display:grid;grid-template-columns:1fr auto 1fr;align-items:center;
  padding:16px 20px;background:rgba(0,0,0,.82);backdrop-filter:blur(10px);-webkit-backdrop-filter:blur(10px);border-bottom:1px solid var(--line)}
.logo{height:22px;display:block}
.live{display:flex;align-items:center;gap:8px;font-size:13px;color:var(--muted)}
.live i{width:8px;height:8px;border-radius:50%;background:#35d07f;animation:ping 1.8s infinite}
.live.off i{background:var(--low);animation:none}
@keyframes ping{0%{box-shadow:0 0 0 0 rgba(53,208,127,.55)}70%,100%{box-shadow:0 0 0 9px rgba(53,208,127,0)}}
.now{justify-self:end;font-size:13px;color:var(--muted)}

/* ---- hero: blue glow + glowing monolith tank ---- */
.hero{position:relative;overflow:hidden;text-align:center;padding:34px 18px 40px;
  background:
    linear-gradient(180deg,transparent 82%,#000 100%),
    radial-gradient(60% 55% at 50% 72%,rgba(255,123,34,.28),transparent 70%),
    radial-gradient(70% 70% at 0% 85%,rgba(17,57,132,.95),transparent 70%),
    radial-gradient(70% 70% at 100% 80%,rgba(0,36,108,.95),transparent 70%),
    linear-gradient(180deg,#000 0%,var(--deep) 30%,#051a52 100%)}
.eyebrow{font-size:12px;font-weight:600;letter-spacing:.22em;text-transform:uppercase;color:var(--muted)}
h1{font-family:var(--serif);font-weight:400;font-size:clamp(34px,8.5vw,64px);line-height:1;letter-spacing:-.01em;margin-top:12px}
h1 em{font-style:italic}

.stage{position:relative;max-width:360px;margin:26px auto 0}
.big{position:relative;z-index:2;font-family:var(--serif);font-size:clamp(108px,32vw,180px);line-height:.8;letter-spacing:-.035em;
  margin-bottom:-.36em;text-shadow:0 6px 30px rgba(0,0,0,.25)}
.big .pc{font-style:italic;font-size:.42em;margin-left:.06em;letter-spacing:0}
.tank{display:block;width:100%;height:auto;overflow:visible}
.mono{filter:drop-shadow(0 0 28px rgba(255,123,34,.55)) drop-shadow(0 0 70px rgba(255,123,34,.25))}
.low .mono{animation:alarm 1.2s ease-in-out infinite}
@keyframes alarm{50%{filter:drop-shadow(0 0 30px rgba(255,61,61,.9)) drop-shadow(0 0 80px rgba(255,61,61,.45))}}
.g0{stop-color:var(--orange)} .g1{stop-color:var(--orange2)} .g2{stop-color:#f6e6ea} .g3{stop-color:var(--ice)}
.wa{stop-color:#3b6cff} .wb{stop-color:#0a2a8c}
.lvl{transition:transform 1.4s cubic-bezier(.22,1,.36,1)}
.w1{animation:wave 4s linear infinite}
.w2{animation:wave 6.5s linear infinite reverse}
@keyframes wave{to{transform:translateX(120px)}}
.bub{fill:rgba(255,255,255,.6);animation:rise 5s ease-in infinite;opacity:0}
@keyframes rise{0%{transform:translateY(0);opacity:0}15%{opacity:.85}100%{transform:translateY(-240px);opacity:0}}
.maxline{stroke:var(--navy);stroke-width:1.6;stroke-dasharray:6 5;opacity:.75}
.maxlabel{fill:var(--navy);font:700 10px var(--sans);letter-spacing:.14em}
.tick{stroke:rgba(255,255,255,.4);stroke-width:1.5}
.tlabel{fill:rgba(255,255,255,.7);font:12px var(--sans)}

/* split badge, like "31st October | Save the date" */
.split{display:inline-flex;margin-top:26px;font-weight:700;font-size:15px}
.split span{padding:10px 16px}
.split .l{background:var(--navy)}
.split .r{background:var(--ice);color:var(--navy)}
.mid .split .r{background:var(--orange);color:#fff}
.low .split .r{background:var(--low);color:#fff}
.na .split .r{background:#5b6475;color:#fff}

/* orange pill, like "Joining us? (->)" */
.cta{display:inline-flex;align-items:center;gap:18px;margin-top:22px;padding:8px 8px 8px 26px;border:0;border-radius:999px;cursor:pointer;
  font:inherit;color:#2a1206;text-align:left;
  background:linear-gradient(90deg,#ff9a5a 0%,var(--orange) 45%,#ffad7a 100%);
  box-shadow:0 0 0 6px rgba(255,123,34,.14),0 14px 34px rgba(255,123,34,.35)}
.cta small{display:block;font-size:11px;font-weight:600;letter-spacing:.12em;text-transform:uppercase;opacity:.75}
.cta b{display:block;font-size:19px}
.cta i{width:46px;height:46px;border-radius:50%;background:var(--navy);display:grid;place-items:center}
.cta svg{width:20px;height:20px;stroke:var(--peach);fill:none;stroke-width:2.2;stroke-linecap:round;stroke-linejoin:round}
.cta.spin svg{animation:spin .8s linear}
@keyframes spin{to{transform:rotate(360deg)}}

/* low water banner */
.alert{display:none;justify-content:center;padding:0 18px;margin-top:18px}
.low .alert{display:flex}
.alert div{display:flex;font-weight:700;font-size:15px;animation:blink 1.2s ease-in-out infinite}
.alert div>span{padding:11px 16px}
.alert .l{background:var(--low)}
.alert .r{background:var(--navy)}
@keyframes blink{50%{opacity:.55}}

/* cards */
.wrap{max-width:1080px;margin:0 auto;padding:22px 18px 30px;display:grid;gap:16px}
.stats{display:grid;grid-template-columns:repeat(4,1fr);gap:14px}
.card{background:linear-gradient(180deg,rgba(17,57,132,.28),rgba(12,26,51,.55));border:1px solid var(--line);border-radius:18px;padding:18px 18px 16px}
.k{font-size:12px;font-weight:600;letter-spacing:.14em;text-transform:uppercase;color:var(--muted)}
.v{font-family:var(--serif);font-size:38px;line-height:1;margin-top:12px;letter-spacing:-.01em}
.v em{font-style:italic;font-size:.6em;margin-left:4px;color:var(--muted)}
.s{font-size:13px;color:var(--muted);margin-top:8px}
.trend .top{display:flex;justify-content:space-between;align-items:baseline;gap:10px;flex-wrap:wrap}
.trend svg{width:100%;height:120px;display:block;margin-top:14px}
.sline{fill:none;stroke:var(--orange2);stroke-width:2.5;stroke-linejoin:round;stroke-linecap:round}
.ga{stop-color:var(--orange)}
.grid{stroke:rgba(255,255,255,.08);stroke-width:1}
.empty{fill:var(--muted);font:13px var(--sans)}
footer{display:flex;justify-content:center;align-items:center;gap:10px;color:var(--muted);font-size:12px;padding:6px 0 26px}
footer img{height:13px;opacity:.7}

@media(min-width:900px){
  .hero{padding:52px 24px 60px}
  .stage{max-width:400px}
}
@media(max-width:780px){.stats{grid-template-columns:repeat(2,1fr)} .v{font-size:32px}}
@media(prefers-reduced-motion:reduce){*{animation:none!important;transition:none!important}}
</style></head>
<body class="na">
<header class="bar">
  <span class="live" id="conn"><i></i><b id="connText">Connecting</b></span>
  <img class="logo" alt="Disrupt.com" src="data:image/png;base64,iVBORw0KGgoAAAANSUhEUgAAAMcAAAAhCAYAAABtGL9ZAAAJdUlEQVR42u2ce5CXZRXHPz92V1xYLsl1hZRrBjIDhCmGuZhdLLtJg0URkabOFKRpI5XShBIyMY42qEnKHTNLJWosbQh3t9g0uVmtwChyEVjEjUpALrJ7+uM9v/Ht5Tzv5fd7fwtb73fmGZbnOc953+dyznPOec77y4lILfFxENgDvAo8r+Vogv4dgSHAYGAdsJcMxaIcGAq8B6gCHsmmJB3kRESK6H8YuB+YBzSH0K1WoTjXVzcOaMiWoGAMB34NDAQ6aN164IJsatJBhyL7dwZuBV6KWJQjAcFAhSVD4eiqJ7B/DXPZtJw+wpFHL6AeuMzRvs2oG5xNf4b/B+EAqARWAudkwpHhf1k4KvSIzpcyYADwEWA+cMDRrxuwPEI4/qXOeFk2/Rnao0NeAZwI6dcNeAiY6Gi/GHjO9/8BwNnAK8D+bNpTwVjgz4G6DcCYbGrSQXmB/f4NfEGF6LNG+03anscOLXHxSRW8EVrO0PpW4GW86NdCYKOj/yeACwN1S4Ht+vfXgcm6wQA+BTylQYLJgX5NwIKQd/2+cQLfjRf2rgK+HWh7FVimfSbpOEcDvYHdOqYHgTWncF+MAz6tSm4QUK3vuw14HPiFCmJcVOgcXwGMUpP6TGAX0Aj8AXgSeD2Ex1RVsn7MAY7r/E0BaoBhatn8Tc38JcAxX5+ewC26xwbrWKaaTxQb5SJCjNJXRI4Y/d8UkTIf3SgRudkoQX7dReRxiY9nReQcg899Bu1lItJJRJYbbZO138eNto0Rc9Bi9OmnbdVG22od5+qIsT2j8+t/1pUiUqtlg9HnoK+9VkRmx1zHfOktIk/EnPs1IjI0Bs9rRWRfDH7HReR+ETnTwafO6FMlIjMca5DHJt96XCEi/wy0L3W9e7HCgYgsdvC4KCAcQfw9wKdSRBolOXZo3yjh+JCIrHLwKJVwnG201YpIQ8yx7RORMb5nfS3h3KxKsI4DRWR7Qv4HROSCEJ6zC1jPv4hIt5jCMTOBEh3rWCuncKQRrfqdo/78hHym411s+XECeACYBTysJkfQRzoX+G4M/l9RU6FNfTqjrkbNlTjooyZk9xK/Z2c1bQYk7PcuvIvIrkbb1cBtBbzL+4GfxaS9IybdeB1fov2ehnBsdtT3SMjnc44N/Q3gB8B1wPt08t4yBCvKf5ri+7sF+CNQp9GzUqE1pG07cIP6VGepDfyYQdcduNPn/9RpsfytQ772OrW742Au3k17ED9U362zzv2deFkRflQDswN1PYFFBr+NwJfVt8uPeYXDZ/xS0ANwvPsh4Hq81KQyw8fLo5P++6D6gjn1Txqds5KCWdXXweNHCc2qPQbNJY5nWnbxqAizKo9HRaS/g29b+BwiIjvV77D43evw4c4I0I016NYn9DEQkV4icszgdYOD/iqHv+D3FWYZNC+ISEcHzzsM+kYRyUWYVS0B8z1fljjm/WmDtqv6akF8K42T480EJkVSLftT4DzHKZMLlE0xnrFUI0S7T3GUcG7IiTXT0M5dgA+X6F2m+KKBeawLidCtNLRtRSCEPNnod3sgauTHXcZ8DI8Rlv4lXvJrEE846Oc59m+tUd8xDeGoctQnNVcsE2AYsEVNt/nABA15FoIW4JunSQj9yZC2g8BvjfoLS/Qulxp1KyL6jDCU01rfndagAP1h9Z1cOAKscvgKYah11LuuDf7kqLcyOMrTEI5qR/0/CtCmLrvyvcA01Qivq70+V23buHg+5JRrS+yJiOfj0IalSrcZZdStLYLfCKNuvSqnMGxwKMcwuPbYUYfSOZaAPhWH3JVs2JiQT71qiq0xaAcAM/QSaWmIgBbzPmmgQ4FKY38KAY646GvUFfOdTZ8Cx3wg4t2SmOmS0MxvLYVw5AJRIP/D1hXArx4vBDxFbdsoDVuptGvULg9Dc4GT2hox/g4J+5QVKFRSIuFoixy3sph76VS8W6JFSIJJeFf31rF8pAjfYLn6F33x7jEmAvfp0egyu6L8idaUfSqw4/v+hbae2SvGM3vHPE3SwBtGXb8i+B2IOZ44J1hzexWOocCPHW0PpfiOu/DyeabrkX2tQ/DGpfCstxMu7JAEJ5CfX5QZaNntW0u0B1426sZG9GnQMfrLuBDndliMU+D8mI7yaS0cw/Eu5TY4HOImvBBbElyikQd/meqIaizCCwsG0SWF+XjLqOuOHU4GuLzA51wT0tYDO5nzxRLtgaeNuqtD6Ptz8g3/cXW6Af6qQQc/uhGendDT0f7UqRSOcodD/XtDcMqAkTE24TSS/ehCftPXGHVLEhzdTSnMx2uO+uk6ruAJcGMC+9mPmTrHLxjKaolhrh0Cni1wTFYUaALvhDvzyqYyoKy+Ciw2+s4y6h4LrPlCvGxlP36CF4Xba4x5MV4qih8vGfPTtnDcWJ6QwrDMwS/qhrxCRHYZNAtE5N0BXheLyF6D9pqIG/I4Gao5B28RkbUiMk1ExovIdY4b/Tz6hiQe+m+9P+97dh8R+ZWD9h7jXePekO826AYEaFwJfI+IyGhN7BwjIosMmqMicl6AX0/HrfO2QNZDfxH5jePZkwI86w2aiY51HOLIWHat+xyD/vbyFOVsqWqbQm39Gzn5cux6PeJf9DnAox3acUUaugIv6e0Wo+0DWjC0epXj5AjzPboAP9cShq3A90qsI+/Cy3MKXjR+UUsYZhj+UDPwGeAZ/jvnbRBeTlsUFgKPcoqRxj3HG3jpAlOLDDeuxEsutGz+Gi2WYGwGrlS7Nw3cjfcxVxwswL6wCzOvTuhmjIP9eJ8mHynxPjihc7gpYb8HQoIya4APhpiqLiV5q2MftBvhENUAN6uzmtYPiT2sm+GVmPTL1D7el+KcNGnkZUsIzTG8PJ2bYsyTJTC3Ad9xBADyqMPLLXqtjfZCsyqgOURnEmwGPoqXMR2G5zSAM5/oG/J6vNv6eZTuTicRco7fdKtxaL3DuhGbCP/GPIhR2N8k1IYI7eXAx3RyOwU270Z1Anc6+g/l5Fj9Tt75TDYOKvDSpieoOfe2hhYb8PKA8qfLSMOZbNCTrNpwQFt8pkYVcJVGfwbqBt2i5kjUJWpXvDRyPw76okZ5jDf67iD8s+WOeDlXl+KlrZyF93nvNuVfV8AG7qHrORIvBB78THZzAXuoEfuephK4yDgdXblVAzn5d9W254r7wcMMEejHyRnALRT+7X6GduZzZMiQCUeGDJlwZMiQIROODBlcyBzD0uIoXmQn6JBnaAf4D8TZn3RjkPyXAAAAAElFTkSuQmCC">
  <span class="now num" id="now"></span>
</header>

<section class="hero">
  <div class="eyebrow">Live water monitor</div>
  <h1><span id="name">Water Tank</span><br><em>Water level</em></h1>

  <div class="alert" role="alert"><div><span class="l">LOW WATER</span><span class="r">Only <span id="alertPct">--%</span> left</span></div></div>

  <div class="stage">
    <div class="big num"><span id="pct">--</span><span class="pc">%</span></div>
    <svg class="tank" viewBox="0 0 300 330" aria-hidden="true">
      <defs>
        <clipPath id="clip"><rect x="50" y="20" width="200" height="300" rx="4"/></clipPath>
        <linearGradient id="mg" x1="0" y1="0" x2="0" y2="1">
          <stop offset="0" class="g0"/><stop offset=".32" class="g1"/><stop offset=".62" class="g2"/><stop offset="1" class="g3"/>
        </linearGradient>
        <radialGradient id="hl" cx=".5" cy=".55" r=".55"><stop offset="0" stop-color="#fff" stop-opacity=".65"/><stop offset="1" stop-color="#fff" stop-opacity="0"/></radialGradient>
        <linearGradient id="wg" x1="0" y1="0" x2="0" y2="1"><stop offset="0" class="wa"/><stop offset="1" class="wb"/></linearGradient>
      </defs>
      <g class="mono">
        <rect x="50" y="20" width="200" height="300" rx="4" fill="url(#mg)"/>
        <rect x="50" y="20" width="200" height="300" rx="4" fill="url(#hl)"/>
      </g>
      <g clip-path="url(#clip)">
        <g id="lvl" class="lvl" style="transform:translateY(320px)">
          <g transform="translate(-40,-7)"><g class="w2"><path fill="#5b85ff" opacity=".55" d="M-180 0Q-150-9-120 0T-60 0T0 0T60 0T120 0T180 0T240 0T300 0T360 0T420 0V340H-180Z"/></g></g>
          <g class="w1"><path fill="url(#wg)" d="M-180 0Q-150-9-120 0T-60 0T0 0T60 0T120 0T180 0T240 0T300 0T360 0T420 0V340H-180Z"/></g>
          <circle class="bub" cx="95" cy="260" r="3" style="animation-delay:0s"/>
          <circle class="bub" cx="150" cy="275" r="2.2" style="animation-delay:1.6s"/>
          <circle class="bub" cx="205" cy="262" r="3.4" style="animation-delay:3.1s"/>
          <circle class="bub" cx="125" cy="280" r="2" style="animation-delay:4.2s"/>
        </g>
      </g>
      <g id="ticks"></g>
    </svg>
  </div>

  <div class="split num"><span class="l" id="ftline">-- ft of -- ft</span><span class="r" id="pill">Connecting</span></div>
  <br>
  <button class="cta" id="cta" type="button" aria-label="Refresh now">
    <span><small>Last update</small><b id="ago">Waiting…</b></span>
    <i><svg viewBox="0 0 24 24"><path d="M20 12a8 8 0 1 1-2.34-5.66"/><path d="M20 4v5h-5"/></svg></i>
  </button>
</section>

<div class="wrap">
  <section class="stats">
    <div class="card"><div class="k">Water height</div><div class="v num" id="hft">--</div><div class="s" id="hcm">&nbsp;</div></div>
    <div class="card"><div class="k" id="volK">Tank depth</div><div class="v num" id="vol">--</div><div class="s" id="volS">&nbsp;</div></div>
    <div class="card"><div class="k">Sensor to water</div><div class="v num" id="dist">--</div><div class="s" id="sens">&nbsp;</div></div>
    <div class="card"><div class="k">Updated at</div><div class="v num" id="clock">--</div><div class="s">Every 2 seconds</div></div>
  </section>

  <section class="card trend">
    <div class="top"><div class="k">Last 60 minutes</div><div class="s num" id="range"></div></div>
    <svg viewBox="0 0 300 100" preserveAspectRatio="none">
      <defs><linearGradient id="ag" x1="0" y1="0" x2="0" y2="1"><stop offset="0" class="ga" stop-opacity=".4"/><stop offset="1" class="ga" stop-opacity="0"/></linearGradient></defs>
      <line class="grid" x1="0" x2="300" y1="10" y2="10"/><line class="grid" x1="0" x2="300" y1="50" y2="50"/><line class="grid" x1="0" x2="300" y1="90" y2="90"/>
      <path id="area" fill="url(#ag)"/><path id="sline" class="sline" vector-effect="non-scaling-stroke"/>
      <text id="empty" class="empty" x="150" y="55" text-anchor="middle">Collecting data…</text>
    </svg>
  </section>
</div>
<footer><img alt="" src="data:image/png;base64,iVBORw0KGgoAAAANSUhEUgAAAMcAAAAhCAYAAABtGL9ZAAAJdUlEQVR42u2ce5CXZRXHPz92V1xYLsl1hZRrBjIDhCmGuZhdLLtJg0URkabOFKRpI5XShBIyMY42qEnKHTNLJWosbQh3t9g0uVmtwChyEVjEjUpALrJ7+uM9v/Ht5Tzv5fd7fwtb73fmGZbnOc953+dyznPOec77y4lILfFxENgDvAo8r+Vogv4dgSHAYGAdsJcMxaIcGAq8B6gCHsmmJB3kRESK6H8YuB+YBzSH0K1WoTjXVzcOaMiWoGAMB34NDAQ6aN164IJsatJBhyL7dwZuBV6KWJQjAcFAhSVD4eiqJ7B/DXPZtJw+wpFHL6AeuMzRvs2oG5xNf4b/B+EAqARWAudkwpHhf1k4KvSIzpcyYADwEWA+cMDRrxuwPEI4/qXOeFk2/Rnao0NeAZwI6dcNeAiY6Gi/GHjO9/8BwNnAK8D+bNpTwVjgz4G6DcCYbGrSQXmB/f4NfEGF6LNG+03anscOLXHxSRW8EVrO0PpW4GW86NdCYKOj/yeACwN1S4Ht+vfXgcm6wQA+BTylQYLJgX5NwIKQd/2+cQLfjRf2rgK+HWh7FVimfSbpOEcDvYHdOqYHgTWncF+MAz6tSm4QUK3vuw14HPiFCmJcVOgcXwGMUpP6TGAX0Aj8AXgSeD2Ex1RVsn7MAY7r/E0BaoBhatn8Tc38JcAxX5+ewC26xwbrWKaaTxQb5SJCjNJXRI4Y/d8UkTIf3SgRudkoQX7dReRxiY9nReQcg899Bu1lItJJRJYbbZO138eNto0Rc9Bi9OmnbdVG22od5+qIsT2j8+t/1pUiUqtlg9HnoK+9VkRmx1zHfOktIk/EnPs1IjI0Bs9rRWRfDH7HReR+ETnTwafO6FMlIjMca5DHJt96XCEi/wy0L3W9e7HCgYgsdvC4KCAcQfw9wKdSRBolOXZo3yjh+JCIrHLwKJVwnG201YpIQ8yx7RORMb5nfS3h3KxKsI4DRWR7Qv4HROSCEJ6zC1jPv4hIt5jCMTOBEh3rWCuncKQRrfqdo/78hHym411s+XECeACYBTysJkfQRzoX+G4M/l9RU6FNfTqjrkbNlTjooyZk9xK/Z2c1bQYk7PcuvIvIrkbb1cBtBbzL+4GfxaS9IybdeB1fov2ehnBsdtT3SMjnc44N/Q3gB8B1wPt08t4yBCvKf5ri+7sF+CNQp9GzUqE1pG07cIP6VGepDfyYQdcduNPn/9RpsfytQ772OrW742Au3k17ED9U362zzv2deFkRflQDswN1PYFFBr+NwJfVt8uPeYXDZ/xS0ANwvPsh4Hq81KQyw8fLo5P++6D6gjn1Txqds5KCWdXXweNHCc2qPQbNJY5nWnbxqAizKo9HRaS/g29b+BwiIjvV77D43evw4c4I0I016NYn9DEQkV4icszgdYOD/iqHv+D3FWYZNC+ISEcHzzsM+kYRyUWYVS0B8z1fljjm/WmDtqv6akF8K42T480EJkVSLftT4DzHKZMLlE0xnrFUI0S7T3GUcG7IiTXT0M5dgA+X6F2m+KKBeawLidCtNLRtRSCEPNnod3sgauTHXcZ8DI8Rlv4lXvJrEE846Oc59m+tUd8xDeGoctQnNVcsE2AYsEVNt/nABA15FoIW4JunSQj9yZC2g8BvjfoLS/Qulxp1KyL6jDCU01rfndagAP1h9Z1cOAKscvgKYah11LuuDf7kqLcyOMrTEI5qR/0/CtCmLrvyvcA01Qivq70+V23buHg+5JRrS+yJiOfj0IalSrcZZdStLYLfCKNuvSqnMGxwKMcwuPbYUYfSOZaAPhWH3JVs2JiQT71qiq0xaAcAM/QSaWmIgBbzPmmgQ4FKY38KAY646GvUFfOdTZ8Cx3wg4t2SmOmS0MxvLYVw5AJRIP/D1hXArx4vBDxFbdsoDVuptGvULg9Dc4GT2hox/g4J+5QVKFRSIuFoixy3sph76VS8W6JFSIJJeFf31rF8pAjfYLn6F33x7jEmAvfp0egyu6L8idaUfSqw4/v+hbae2SvGM3vHPE3SwBtGXb8i+B2IOZ44J1hzexWOocCPHW0PpfiOu/DyeabrkX2tQ/DGpfCstxMu7JAEJ5CfX5QZaNntW0u0B1426sZG9GnQMfrLuBDndliMU+D8mI7yaS0cw/Eu5TY4HOImvBBbElyikQd/meqIaizCCwsG0SWF+XjLqOuOHU4GuLzA51wT0tYDO5nzxRLtgaeNuqtD6Ptz8g3/cXW6Af6qQQc/uhGendDT0f7UqRSOcodD/XtDcMqAkTE24TSS/ehCftPXGHVLEhzdTSnMx2uO+uk6ruAJcGMC+9mPmTrHLxjKaolhrh0Cni1wTFYUaALvhDvzyqYyoKy+Ciw2+s4y6h4LrPlCvGxlP36CF4Xba4x5MV4qih8vGfPTtnDcWJ6QwrDMwS/qhrxCRHYZNAtE5N0BXheLyF6D9pqIG/I4Gao5B28RkbUiMk1ExovIdY4b/Tz6hiQe+m+9P+97dh8R+ZWD9h7jXePekO826AYEaFwJfI+IyGhN7BwjIosMmqMicl6AX0/HrfO2QNZDfxH5jePZkwI86w2aiY51HOLIWHat+xyD/vbyFOVsqWqbQm39Gzn5cux6PeJf9DnAox3acUUaugIv6e0Wo+0DWjC0epXj5AjzPboAP9cShq3A90qsI+/Cy3MKXjR+UUsYZhj+UDPwGeAZ/jvnbRBeTlsUFgKPcoqRxj3HG3jpAlOLDDeuxEsutGz+Gi2WYGwGrlS7Nw3cjfcxVxwswL6wCzOvTuhmjIP9eJ8mHynxPjihc7gpYb8HQoIya4APhpiqLiV5q2MftBvhENUAN6uzmtYPiT2sm+GVmPTL1D7el+KcNGnkZUsIzTG8PJ2bYsyTJTC3Ad9xBADyqMPLLXqtjfZCsyqgOURnEmwGPoqXMR2G5zSAM5/oG/J6vNv6eZTuTicRco7fdKtxaL3DuhGbCP/GPIhR2N8k1IYI7eXAx3RyOwU270Z1Anc6+g/l5Fj9Tt75TDYOKvDSpieoOfe2hhYb8PKA8qfLSMOZbNCTrNpwQFt8pkYVcJVGfwbqBt2i5kjUJWpXvDRyPw76okZ5jDf67iD8s+WOeDlXl+KlrZyF93nvNuVfV8AG7qHrORIvBB78THZzAXuoEfuephK4yDgdXblVAzn5d9W254r7wcMMEejHyRnALRT+7X6GduZzZMiQCUeGDJlwZMiQIROODBlcyBzD0uIoXmQn6JBnaAf4D8TZn3RjkPyXAAAAAElFTkSuQmCC"><span>Tank monitor</span></footer>

<script>
const $ = id => document.getElementById(id);
const FT = 30.48, TOP = 20, H = 300;
let shown = 0, lastOk = 0, fails = 0, ticksDone = false, timer = 0;

function countTo(to) {
  const from = shown, t0 = performance.now();
  cancelAnimationFrame(countTo.raf);
  const step = t => {
    const k = Math.min(1, (t - t0) / 1100), e = 1 - Math.pow(1 - k, 3);
    $('pct').textContent = Math.round(from + (to - from) * e);
    if (k < 1) countTo.raf = requestAnimationFrame(step);
  };
  countTo.raf = requestAnimationFrame(step);
  shown = to;
}

// Foot scale right of the tank, plus the dashed MAX line inside it
function drawTicks(depthCm, maxCm) {
  const ns = 'http://www.w3.org/2000/svg', g = $('ticks');
  const y = cm => TOP + H - H * cm / depthCm;
  const el = (tag, attrs, text) => {
    const e = document.createElementNS(ns, tag);
    for (const a in attrs) e.setAttribute(a, attrs[a]);
    if (text) e.textContent = text;
    g.appendChild(e);
  };
  for (let f = 0; f * FT <= depthCm + 0.5; f++) {
    el('line', {class: 'tick', x1: 256, x2: 266, y1: y(f * FT), y2: y(f * FT)});
    el('text', {class: 'tlabel', x: 271, y: y(f * FT) + 4}, f + ' ft');
  }
  el('line', {class: 'maxline', x1: 50, x2: 250, y1: y(maxCm), y2: y(maxCm)});
  el('text', {class: 'maxlabel', x: 60, y: y(maxCm) - 7}, 'MAX ' + (maxCm / FT).toFixed(1) + ' FT');
}

function drawTrend(hist) {
  const pts = [], n = 60, dx = 300 / (n - 1), off = n - hist.length;
  hist.forEach((v, i) => { if (v >= 0) pts.push([(off + i) * dx, 90 - v * 0.8]); });
  $('empty').style.display = pts.length > 1 ? 'none' : '';
  if (pts.length < 2) { $('sline').setAttribute('d', ''); $('area').setAttribute('d', ''); $('range').textContent = ''; return; }
  const line = pts.map((p, i) => (i ? 'L' : 'M') + p[0].toFixed(1) + ' ' + p[1].toFixed(1)).join('');
  $('sline').setAttribute('d', line);
  $('area').setAttribute('d', line + 'L' + pts[pts.length - 1][0].toFixed(1) + ' 100L' + pts[0][0].toFixed(1) + ' 100Z');
  const vals = hist.filter(v => v >= 0);
  $('range').textContent = 'Low ' + Math.min(...vals) + '%  ·  High ' + Math.max(...vals) + '%';
}

function setState(cls, text) {
  document.body.className = cls;
  $('pill').textContent = text;
}

function render(d) {
  document.title = d.name + ' · ' + (d.ok ? d.pct + '%' : '--');
  $('name').textContent = d.name;
  if (!ticksDone) { drawTicks(d.depthCm, d.maxCm); ticksDone = true; }
  drawTrend(d.hist || []);
  const maxFt = (d.maxCm / FT).toFixed(1);

  if (d.cap > 0) {
    $('volK').textContent = 'Water in tank';
    $('vol').innerHTML = Math.round(d.cap * d.pct / 100).toLocaleString() + '<em>L</em>';
    $('volS').textContent = 'of ' + Math.round(d.cap).toLocaleString() + ' L';
  } else {
    $('vol').innerHTML = (d.depthCm / FT).toFixed(1) + '<em>ft</em>';
    $('volS').textContent = 'Max water ' + maxFt + ' ft';
  }

  if (!d.ok) {
    setState('na', 'Check sensor');
    $('pct').textContent = '--';
    $('ftline').textContent = '-- ft of ' + maxFt + ' ft';
    $('hft').textContent = '--'; $('hcm').innerHTML = '&nbsp;';
    $('dist').textContent = '--'; $('sens').textContent = 'No echo from sensor';
    return;
  }
  lastOk = Date.now();
  countTo(d.pct);
  $('lvl').style.transform = 'translateY(' + (TOP + H - H * Math.min(1, d.waterCm / d.depthCm)).toFixed(1) + 'px)';
  $('ftline').textContent = (d.waterCm / FT).toFixed(2) + ' ft of ' + maxFt + ' ft';
  $('hft').innerHTML = (d.waterCm / FT).toFixed(2) + '<em>ft</em>';
  $('hcm').textContent = Math.round(d.waterCm) + ' cm';
  $('dist').innerHTML = Math.round(d.distCm) + '<em>cm</em>';
  $('sens').textContent = 'Sensor online';
  $('alertPct').textContent = d.pct + '%';
  if (d.pct < d.low) setState('low', 'Low water');
  else if (d.pct < 50) setState('mid', 'Half full');
  else setState('ok', 'Good level');
}

function tickClock() {
  const now = new Date();
  $('now').textContent = now.toLocaleTimeString([], {hour: '2-digit', minute: '2-digit'});
  if (lastOk) {
    const s = Math.round((Date.now() - lastOk) / 1000);
    $('ago').textContent = s < 3 ? 'Just now' : s < 60 ? s + ' seconds ago' : Math.floor(s / 60) + ' min ago';
    $('clock').textContent = new Date(lastOk).toLocaleTimeString([], {hour: '2-digit', minute: '2-digit', second: '2-digit', hour12: false});
  }
}

async function poll() {
  clearTimeout(timer);
  try {
    const r = await fetch('/data', {cache: 'no-store'});
    render(await r.json());
    fails = 0;
    $('conn').classList.remove('off');
    $('connText').textContent = 'Live';
  } catch (e) {
    if (++fails >= 3) { $('conn').classList.add('off'); $('connText').textContent = 'Offline'; }
  }
  timer = setTimeout(poll, 2000);
}

$('cta').onclick = () => {
  const c = $('cta');
  c.classList.remove('spin'); void c.offsetWidth; c.classList.add('spin');
  poll();
};
setInterval(tickClock, 1000);
tickClock();
poll();
</script>
</body></html>
)rawliteral";
